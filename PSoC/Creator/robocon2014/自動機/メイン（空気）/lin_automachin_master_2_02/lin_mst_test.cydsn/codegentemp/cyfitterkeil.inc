#ifndef INCLUDED_CYFITTERKEIL_INC
#define INCLUDED_CYFITTERKEIL_INC
$INCLUDE (cydevicekeil.inc)
$INCLUDE (cydevicekeil_trm.inc)

; UART_2_TXInternalInterrupt
UART_2_TXInternalInterrupt__ES2_PATCH EQU 0
UART_2_TXInternalInterrupt__INTC_CLR_EN_REG EQU CYREG_INTC_CLR_EN0
UART_2_TXInternalInterrupt__INTC_CLR_PD_REG EQU CYREG_INTC_CLR_PD0
UART_2_TXInternalInterrupt__INTC_MASK EQU 0x08
UART_2_TXInternalInterrupt__INTC_NUMBER EQU 3
UART_2_TXInternalInterrupt__INTC_PRIOR_NUM EQU 7
UART_2_TXInternalInterrupt__INTC_PRIOR_REG EQU CYREG_INTC_PRIOR3
UART_2_TXInternalInterrupt__INTC_SET_EN_REG EQU CYREG_INTC_SET_EN0
UART_2_TXInternalInterrupt__INTC_SET_PD_REG EQU CYREG_INTC_SET_PD0
UART_2_TXInternalInterrupt__INTC_VECT EQU (CYREG_INTC_VECT_MBASE+0x06)

; LIN_RXInternalInterrupt
LIN_RXInternalInterrupt__ES2_PATCH EQU 0
LIN_RXInternalInterrupt__INTC_CLR_EN_REG EQU CYREG_INTC_CLR_EN0
LIN_RXInternalInterrupt__INTC_CLR_PD_REG EQU CYREG_INTC_CLR_PD0
LIN_RXInternalInterrupt__INTC_MASK EQU 0x01
LIN_RXInternalInterrupt__INTC_NUMBER EQU 0
LIN_RXInternalInterrupt__INTC_PRIOR_NUM EQU 7
LIN_RXInternalInterrupt__INTC_PRIOR_REG EQU CYREG_INTC_PRIOR0
LIN_RXInternalInterrupt__INTC_SET_EN_REG EQU CYREG_INTC_SET_EN0
LIN_RXInternalInterrupt__INTC_SET_PD_REG EQU CYREG_INTC_SET_PD0
LIN_RXInternalInterrupt__INTC_VECT EQU (CYREG_INTC_VECT_MBASE+0x00)

; LIN_TXInternalInterrupt
LIN_TXInternalInterrupt__ES2_PATCH EQU 0
LIN_TXInternalInterrupt__INTC_CLR_EN_REG EQU CYREG_INTC_CLR_EN0
LIN_TXInternalInterrupt__INTC_CLR_PD_REG EQU CYREG_INTC_CLR_PD0
LIN_TXInternalInterrupt__INTC_MASK EQU 0x02
LIN_TXInternalInterrupt__INTC_NUMBER EQU 1
LIN_TXInternalInterrupt__INTC_PRIOR_NUM EQU 7
LIN_TXInternalInterrupt__INTC_PRIOR_REG EQU CYREG_INTC_PRIOR1
LIN_TXInternalInterrupt__INTC_SET_EN_REG EQU CYREG_INTC_SET_EN0
LIN_TXInternalInterrupt__INTC_SET_PD_REG EQU CYREG_INTC_SET_PD0
LIN_TXInternalInterrupt__INTC_VECT EQU (CYREG_INTC_VECT_MBASE+0x02)

; PS2_RXInternalInterrupt
PS2_RXInternalInterrupt__ES2_PATCH EQU 0
PS2_RXInternalInterrupt__INTC_CLR_EN_REG EQU CYREG_INTC_CLR_EN0
PS2_RXInternalInterrupt__INTC_CLR_PD_REG EQU CYREG_INTC_CLR_PD0
PS2_RXInternalInterrupt__INTC_MASK EQU 0x04
PS2_RXInternalInterrupt__INTC_NUMBER EQU 2
PS2_RXInternalInterrupt__INTC_PRIOR_NUM EQU 7
PS2_RXInternalInterrupt__INTC_PRIOR_REG EQU CYREG_INTC_PRIOR2
PS2_RXInternalInterrupt__INTC_SET_EN_REG EQU CYREG_INTC_SET_EN0
PS2_RXInternalInterrupt__INTC_SET_PD_REG EQU CYREG_INTC_SET_PD0
PS2_RXInternalInterrupt__INTC_VECT EQU (CYREG_INTC_VECT_MBASE+0x04)

; LIN_Timer_TimerUDB
LIN_Timer_TimerUDB_rstSts_stsreg__0__MASK EQU 0x01
LIN_Timer_TimerUDB_rstSts_stsreg__0__POS EQU 0
LIN_Timer_TimerUDB_rstSts_stsreg__16BIT_STATUS_AUX_CTL_REG EQU CYREG_B0_UDB12_13_ACTL
LIN_Timer_TimerUDB_rstSts_stsreg__16BIT_STATUS_REG EQU CYREG_B0_UDB12_13_ST
LIN_Timer_TimerUDB_rstSts_stsreg__2__MASK EQU 0x04
LIN_Timer_TimerUDB_rstSts_stsreg__2__POS EQU 2
LIN_Timer_TimerUDB_rstSts_stsreg__3__MASK EQU 0x08
LIN_Timer_TimerUDB_rstSts_stsreg__3__POS EQU 3
LIN_Timer_TimerUDB_rstSts_stsreg__MASK EQU 0x0D
LIN_Timer_TimerUDB_rstSts_stsreg__MASK_REG EQU CYREG_B0_UDB12_MSK
LIN_Timer_TimerUDB_rstSts_stsreg__MASK_ST_AUX_CTL_REG EQU CYREG_B0_UDB12_MSK_ACTL
LIN_Timer_TimerUDB_rstSts_stsreg__PER_ST_AUX_CTL_REG EQU CYREG_B0_UDB12_MSK_ACTL
LIN_Timer_TimerUDB_rstSts_stsreg__STATUS_AUX_CTL_REG EQU CYREG_B0_UDB12_ACTL
LIN_Timer_TimerUDB_rstSts_stsreg__STATUS_CNT_REG EQU CYREG_B0_UDB12_ST_CTL
LIN_Timer_TimerUDB_rstSts_stsreg__STATUS_CONTROL_REG EQU CYREG_B0_UDB12_ST_CTL
LIN_Timer_TimerUDB_rstSts_stsreg__STATUS_REG EQU CYREG_B0_UDB12_ST
LIN_Timer_TimerUDB_sCTRLReg_SyncCtl_ctrlreg__16BIT_CONTROL_AUX_CTL_REG EQU CYREG_B0_UDB12_13_ACTL
LIN_Timer_TimerUDB_sCTRLReg_SyncCtl_ctrlreg__16BIT_CONTROL_CONTROL_REG EQU CYREG_B0_UDB12_13_CTL
LIN_Timer_TimerUDB_sCTRLReg_SyncCtl_ctrlreg__16BIT_CONTROL_COUNT_REG EQU CYREG_B0_UDB12_13_CTL
LIN_Timer_TimerUDB_sCTRLReg_SyncCtl_ctrlreg__16BIT_COUNT_CONTROL_REG EQU CYREG_B0_UDB12_13_CTL
LIN_Timer_TimerUDB_sCTRLReg_SyncCtl_ctrlreg__16BIT_COUNT_COUNT_REG EQU CYREG_B0_UDB12_13_CTL
LIN_Timer_TimerUDB_sCTRLReg_SyncCtl_ctrlreg__16BIT_MASK_MASK_REG EQU CYREG_B0_UDB12_13_MSK
LIN_Timer_TimerUDB_sCTRLReg_SyncCtl_ctrlreg__16BIT_MASK_PERIOD_REG EQU CYREG_B0_UDB12_13_MSK
LIN_Timer_TimerUDB_sCTRLReg_SyncCtl_ctrlreg__16BIT_PERIOD_MASK_REG EQU CYREG_B0_UDB12_13_MSK
LIN_Timer_TimerUDB_sCTRLReg_SyncCtl_ctrlreg__16BIT_PERIOD_PERIOD_REG EQU CYREG_B0_UDB12_13_MSK
LIN_Timer_TimerUDB_sCTRLReg_SyncCtl_ctrlreg__7__MASK EQU 0x80
LIN_Timer_TimerUDB_sCTRLReg_SyncCtl_ctrlreg__7__POS EQU 7
LIN_Timer_TimerUDB_sCTRLReg_SyncCtl_ctrlreg__CONTROL_AUX_CTL_REG EQU CYREG_B0_UDB12_ACTL
LIN_Timer_TimerUDB_sCTRLReg_SyncCtl_ctrlreg__CONTROL_REG EQU CYREG_B0_UDB12_CTL
LIN_Timer_TimerUDB_sCTRLReg_SyncCtl_ctrlreg__CONTROL_ST_REG EQU CYREG_B0_UDB12_ST_CTL
LIN_Timer_TimerUDB_sCTRLReg_SyncCtl_ctrlreg__COUNT_REG EQU CYREG_B0_UDB12_CTL
LIN_Timer_TimerUDB_sCTRLReg_SyncCtl_ctrlreg__COUNT_ST_REG EQU CYREG_B0_UDB12_ST_CTL
LIN_Timer_TimerUDB_sCTRLReg_SyncCtl_ctrlreg__MASK EQU 0x80
LIN_Timer_TimerUDB_sCTRLReg_SyncCtl_ctrlreg__MASK_CTL_AUX_CTL_REG EQU CYREG_B0_UDB12_MSK_ACTL
LIN_Timer_TimerUDB_sCTRLReg_SyncCtl_ctrlreg__PERIOD_REG EQU CYREG_B0_UDB12_MSK
LIN_Timer_TimerUDB_sCTRLReg_SyncCtl_ctrlreg__PER_CTL_AUX_CTL_REG EQU CYREG_B0_UDB12_MSK_ACTL
LIN_Timer_TimerUDB_sT8_timerdp_u0__16BIT_A0_REG EQU CYREG_B0_UDB12_13_A0
LIN_Timer_TimerUDB_sT8_timerdp_u0__16BIT_A1_REG EQU CYREG_B0_UDB12_13_A1
LIN_Timer_TimerUDB_sT8_timerdp_u0__16BIT_D0_REG EQU CYREG_B0_UDB12_13_D0
LIN_Timer_TimerUDB_sT8_timerdp_u0__16BIT_D1_REG EQU CYREG_B0_UDB12_13_D1
LIN_Timer_TimerUDB_sT8_timerdp_u0__16BIT_DP_AUX_CTL_REG EQU CYREG_B0_UDB12_13_ACTL
LIN_Timer_TimerUDB_sT8_timerdp_u0__16BIT_F0_REG EQU CYREG_B0_UDB12_13_F0
LIN_Timer_TimerUDB_sT8_timerdp_u0__16BIT_F1_REG EQU CYREG_B0_UDB12_13_F1
LIN_Timer_TimerUDB_sT8_timerdp_u0__A0_A1_REG EQU CYREG_B0_UDB12_A0_A1
LIN_Timer_TimerUDB_sT8_timerdp_u0__A0_REG EQU CYREG_B0_UDB12_A0
LIN_Timer_TimerUDB_sT8_timerdp_u0__A1_REG EQU CYREG_B0_UDB12_A1
LIN_Timer_TimerUDB_sT8_timerdp_u0__D0_D1_REG EQU CYREG_B0_UDB12_D0_D1
LIN_Timer_TimerUDB_sT8_timerdp_u0__D0_REG EQU CYREG_B0_UDB12_D0
LIN_Timer_TimerUDB_sT8_timerdp_u0__D1_REG EQU CYREG_B0_UDB12_D1
LIN_Timer_TimerUDB_sT8_timerdp_u0__DP_AUX_CTL_REG EQU CYREG_B0_UDB12_ACTL
LIN_Timer_TimerUDB_sT8_timerdp_u0__F0_F1_REG EQU CYREG_B0_UDB12_F0_F1
LIN_Timer_TimerUDB_sT8_timerdp_u0__F0_REG EQU CYREG_B0_UDB12_F0
LIN_Timer_TimerUDB_sT8_timerdp_u0__F1_REG EQU CYREG_B0_UDB12_F1
LIN_Timer_TimerUDB_sT8_timerdp_u0__MSK_DP_AUX_CTL_REG EQU CYREG_B0_UDB12_MSK_ACTL
LIN_Timer_TimerUDB_sT8_timerdp_u0__PER_DP_AUX_CTL_REG EQU CYREG_B0_UDB12_MSK_ACTL

; UART_2_IntClock
UART_2_IntClock__CFG0 EQU CYREG_CLKDIST_DCFG1_CFG0
UART_2_IntClock__CFG1 EQU CYREG_CLKDIST_DCFG1_CFG1
UART_2_IntClock__CFG2 EQU CYREG_CLKDIST_DCFG1_CFG2
UART_2_IntClock__CFG2_SRC_SEL_MASK EQU 0x07
UART_2_IntClock__INDEX EQU 0x01
UART_2_IntClock__PM_ACT_CFG EQU CYREG_PM_ACT_CFG2
UART_2_IntClock__PM_ACT_MSK EQU 0x02
UART_2_IntClock__PM_STBY_CFG EQU CYREG_PM_STBY_CFG2
UART_2_IntClock__PM_STBY_MSK EQU 0x02

; lin_timer_isr
lin_timer_isr__ES2_PATCH EQU 0
lin_timer_isr__INTC_CLR_EN_REG EQU CYREG_INTC_CLR_EN0
lin_timer_isr__INTC_CLR_PD_REG EQU CYREG_INTC_CLR_PD0
lin_timer_isr__INTC_MASK EQU 0x20
lin_timer_isr__INTC_NUMBER EQU 5
lin_timer_isr__INTC_PRIOR_NUM EQU 7
lin_timer_isr__INTC_PRIOR_REG EQU CYREG_INTC_PRIOR5
lin_timer_isr__INTC_SET_EN_REG EQU CYREG_INTC_SET_EN0
lin_timer_isr__INTC_SET_PD_REG EQU CYREG_INTC_SET_PD0
lin_timer_isr__INTC_VECT EQU (CYREG_INTC_VECT_MBASE+0x0A)

; LIN_IntClock
LIN_IntClock__CFG0 EQU CYREG_CLKDIST_DCFG2_CFG0
LIN_IntClock__CFG1 EQU CYREG_CLKDIST_DCFG2_CFG1
LIN_IntClock__CFG2 EQU CYREG_CLKDIST_DCFG2_CFG2
LIN_IntClock__CFG2_SRC_SEL_MASK EQU 0x07
LIN_IntClock__INDEX EQU 0x02
LIN_IntClock__PM_ACT_CFG EQU CYREG_PM_ACT_CFG2
LIN_IntClock__PM_ACT_MSK EQU 0x04
LIN_IntClock__PM_STBY_CFG EQU CYREG_PM_STBY_CFG2
LIN_IntClock__PM_STBY_MSK EQU 0x04

; PS2_IntClock
PS2_IntClock__CFG0 EQU CYREG_CLKDIST_DCFG0_CFG0
PS2_IntClock__CFG1 EQU CYREG_CLKDIST_DCFG0_CFG1
PS2_IntClock__CFG2 EQU CYREG_CLKDIST_DCFG0_CFG2
PS2_IntClock__CFG2_SRC_SEL_MASK EQU 0x07
PS2_IntClock__INDEX EQU 0x00
PS2_IntClock__PM_ACT_CFG EQU CYREG_PM_ACT_CFG2
PS2_IntClock__PM_ACT_MSK EQU 0x01
PS2_IntClock__PM_STBY_CFG EQU CYREG_PM_STBY_CFG2
PS2_IntClock__PM_STBY_MSK EQU 0x01

; UART_2_BUART
UART_2_BUART_sTX_TxShifter_u0__16BIT_A0_REG EQU CYREG_B0_UDB13_14_A0
UART_2_BUART_sTX_TxShifter_u0__16BIT_A1_REG EQU CYREG_B0_UDB13_14_A1
UART_2_BUART_sTX_TxShifter_u0__16BIT_D0_REG EQU CYREG_B0_UDB13_14_D0
UART_2_BUART_sTX_TxShifter_u0__16BIT_D1_REG EQU CYREG_B0_UDB13_14_D1
UART_2_BUART_sTX_TxShifter_u0__16BIT_DP_AUX_CTL_REG EQU CYREG_B0_UDB13_14_ACTL
UART_2_BUART_sTX_TxShifter_u0__16BIT_F0_REG EQU CYREG_B0_UDB13_14_F0
UART_2_BUART_sTX_TxShifter_u0__16BIT_F1_REG EQU CYREG_B0_UDB13_14_F1
UART_2_BUART_sTX_TxShifter_u0__A0_A1_REG EQU CYREG_B0_UDB13_A0_A1
UART_2_BUART_sTX_TxShifter_u0__A0_REG EQU CYREG_B0_UDB13_A0
UART_2_BUART_sTX_TxShifter_u0__A1_REG EQU CYREG_B0_UDB13_A1
UART_2_BUART_sTX_TxShifter_u0__D0_D1_REG EQU CYREG_B0_UDB13_D0_D1
UART_2_BUART_sTX_TxShifter_u0__D0_REG EQU CYREG_B0_UDB13_D0
UART_2_BUART_sTX_TxShifter_u0__D1_REG EQU CYREG_B0_UDB13_D1
UART_2_BUART_sTX_TxShifter_u0__DP_AUX_CTL_REG EQU CYREG_B0_UDB13_ACTL
UART_2_BUART_sTX_TxShifter_u0__F0_F1_REG EQU CYREG_B0_UDB13_F0_F1
UART_2_BUART_sTX_TxShifter_u0__F0_REG EQU CYREG_B0_UDB13_F0
UART_2_BUART_sTX_TxShifter_u0__F1_REG EQU CYREG_B0_UDB13_F1
UART_2_BUART_sTX_TxSts__0__MASK EQU 0x01
UART_2_BUART_sTX_TxSts__0__POS EQU 0
UART_2_BUART_sTX_TxSts__16BIT_STATUS_AUX_CTL_REG EQU CYREG_B0_UDB14_15_ACTL
UART_2_BUART_sTX_TxSts__16BIT_STATUS_REG EQU CYREG_B0_UDB14_15_ST
UART_2_BUART_sTX_TxSts__1__MASK EQU 0x02
UART_2_BUART_sTX_TxSts__1__POS EQU 1
UART_2_BUART_sTX_TxSts__2__MASK EQU 0x04
UART_2_BUART_sTX_TxSts__2__POS EQU 2
UART_2_BUART_sTX_TxSts__3__MASK EQU 0x08
UART_2_BUART_sTX_TxSts__3__POS EQU 3
UART_2_BUART_sTX_TxSts__MASK EQU 0x0F
UART_2_BUART_sTX_TxSts__MASK_REG EQU CYREG_B0_UDB14_MSK
UART_2_BUART_sTX_TxSts__STATUS_AUX_CTL_REG EQU CYREG_B0_UDB14_ACTL
UART_2_BUART_sTX_TxSts__STATUS_REG EQU CYREG_B0_UDB14_ST
UART_2_BUART_sTX_sCLOCK_TxBitClkGen__16BIT_A0_REG EQU CYREG_B0_UDB10_11_A0
UART_2_BUART_sTX_sCLOCK_TxBitClkGen__16BIT_A1_REG EQU CYREG_B0_UDB10_11_A1
UART_2_BUART_sTX_sCLOCK_TxBitClkGen__16BIT_D0_REG EQU CYREG_B0_UDB10_11_D0
UART_2_BUART_sTX_sCLOCK_TxBitClkGen__16BIT_D1_REG EQU CYREG_B0_UDB10_11_D1
UART_2_BUART_sTX_sCLOCK_TxBitClkGen__16BIT_DP_AUX_CTL_REG EQU CYREG_B0_UDB10_11_ACTL
UART_2_BUART_sTX_sCLOCK_TxBitClkGen__16BIT_F0_REG EQU CYREG_B0_UDB10_11_F0
UART_2_BUART_sTX_sCLOCK_TxBitClkGen__16BIT_F1_REG EQU CYREG_B0_UDB10_11_F1
UART_2_BUART_sTX_sCLOCK_TxBitClkGen__A0_A1_REG EQU CYREG_B0_UDB10_A0_A1
UART_2_BUART_sTX_sCLOCK_TxBitClkGen__A0_REG EQU CYREG_B0_UDB10_A0
UART_2_BUART_sTX_sCLOCK_TxBitClkGen__A1_REG EQU CYREG_B0_UDB10_A1
UART_2_BUART_sTX_sCLOCK_TxBitClkGen__D0_D1_REG EQU CYREG_B0_UDB10_D0_D1
UART_2_BUART_sTX_sCLOCK_TxBitClkGen__D0_REG EQU CYREG_B0_UDB10_D0
UART_2_BUART_sTX_sCLOCK_TxBitClkGen__D1_REG EQU CYREG_B0_UDB10_D1
UART_2_BUART_sTX_sCLOCK_TxBitClkGen__DP_AUX_CTL_REG EQU CYREG_B0_UDB10_ACTL
UART_2_BUART_sTX_sCLOCK_TxBitClkGen__F0_F1_REG EQU CYREG_B0_UDB10_F0_F1
UART_2_BUART_sTX_sCLOCK_TxBitClkGen__F0_REG EQU CYREG_B0_UDB10_F0
UART_2_BUART_sTX_sCLOCK_TxBitClkGen__F1_REG EQU CYREG_B0_UDB10_F1

; timer_clock
timer_clock__CFG0 EQU CYREG_CLKDIST_DCFG3_CFG0
timer_clock__CFG1 EQU CYREG_CLKDIST_DCFG3_CFG1
timer_clock__CFG2 EQU CYREG_CLKDIST_DCFG3_CFG2
timer_clock__CFG2_SRC_SEL_MASK EQU 0x07
timer_clock__INDEX EQU 0x03
timer_clock__PM_ACT_CFG EQU CYREG_PM_ACT_CFG2
timer_clock__PM_ACT_MSK EQU 0x08
timer_clock__PM_STBY_CFG EQU CYREG_PM_STBY_CFG2
timer_clock__PM_STBY_MSK EQU 0x08

; uart_rx_isr
uart_rx_isr__ES2_PATCH EQU 0
uart_rx_isr__INTC_CLR_EN_REG EQU CYREG_INTC_CLR_EN0
uart_rx_isr__INTC_CLR_PD_REG EQU CYREG_INTC_CLR_PD0
uart_rx_isr__INTC_MASK EQU 0x40
uart_rx_isr__INTC_NUMBER EQU 6
uart_rx_isr__INTC_PRIOR_NUM EQU 7
uart_rx_isr__INTC_PRIOR_REG EQU CYREG_INTC_PRIOR6
uart_rx_isr__INTC_SET_EN_REG EQU CYREG_INTC_SET_EN0
uart_rx_isr__INTC_SET_PD_REG EQU CYREG_INTC_SET_PD0
uart_rx_isr__INTC_VECT EQU (CYREG_INTC_VECT_MBASE+0x0C)

; uart_tx_isr
uart_tx_isr__ES2_PATCH EQU 0
uart_tx_isr__INTC_CLR_EN_REG EQU CYREG_INTC_CLR_EN0
uart_tx_isr__INTC_CLR_PD_REG EQU CYREG_INTC_CLR_PD0
uart_tx_isr__INTC_MASK EQU 0x80
uart_tx_isr__INTC_NUMBER EQU 7
uart_tx_isr__INTC_PRIOR_NUM EQU 7
uart_tx_isr__INTC_PRIOR_REG EQU CYREG_INTC_PRIOR7
uart_tx_isr__INTC_SET_EN_REG EQU CYREG_INTC_SET_EN0
uart_tx_isr__INTC_SET_PD_REG EQU CYREG_INTC_SET_PD0
uart_tx_isr__INTC_VECT EQU (CYREG_INTC_VECT_MBASE+0x0E)

; LIN_BUART
LIN_BUART_sRX_RxBitCounter_ST__16BIT_STATUS_AUX_CTL_REG EQU CYREG_B0_UDB11_12_ACTL
LIN_BUART_sRX_RxBitCounter_ST__16BIT_STATUS_REG EQU CYREG_B0_UDB11_12_ST
LIN_BUART_sRX_RxBitCounter_ST__MASK_REG EQU CYREG_B0_UDB11_MSK
LIN_BUART_sRX_RxBitCounter_ST__MASK_ST_AUX_CTL_REG EQU CYREG_B0_UDB11_MSK_ACTL
LIN_BUART_sRX_RxBitCounter_ST__PER_ST_AUX_CTL_REG EQU CYREG_B0_UDB11_MSK_ACTL
LIN_BUART_sRX_RxBitCounter_ST__STATUS_AUX_CTL_REG EQU CYREG_B0_UDB11_ACTL
LIN_BUART_sRX_RxBitCounter_ST__STATUS_CNT_REG EQU CYREG_B0_UDB11_ST_CTL
LIN_BUART_sRX_RxBitCounter_ST__STATUS_CONTROL_REG EQU CYREG_B0_UDB11_ST_CTL
LIN_BUART_sRX_RxBitCounter_ST__STATUS_REG EQU CYREG_B0_UDB11_ST
LIN_BUART_sRX_RxBitCounter__16BIT_CONTROL_AUX_CTL_REG EQU CYREG_B0_UDB11_12_ACTL
LIN_BUART_sRX_RxBitCounter__16BIT_CONTROL_CONTROL_REG EQU CYREG_B0_UDB11_12_CTL
LIN_BUART_sRX_RxBitCounter__16BIT_CONTROL_COUNT_REG EQU CYREG_B0_UDB11_12_CTL
LIN_BUART_sRX_RxBitCounter__16BIT_COUNT_CONTROL_REG EQU CYREG_B0_UDB11_12_CTL
LIN_BUART_sRX_RxBitCounter__16BIT_COUNT_COUNT_REG EQU CYREG_B0_UDB11_12_CTL
LIN_BUART_sRX_RxBitCounter__16BIT_MASK_MASK_REG EQU CYREG_B0_UDB11_12_MSK
LIN_BUART_sRX_RxBitCounter__16BIT_MASK_PERIOD_REG EQU CYREG_B0_UDB11_12_MSK
LIN_BUART_sRX_RxBitCounter__16BIT_PERIOD_MASK_REG EQU CYREG_B0_UDB11_12_MSK
LIN_BUART_sRX_RxBitCounter__16BIT_PERIOD_PERIOD_REG EQU CYREG_B0_UDB11_12_MSK
LIN_BUART_sRX_RxBitCounter__CONTROL_AUX_CTL_REG EQU CYREG_B0_UDB11_ACTL
LIN_BUART_sRX_RxBitCounter__CONTROL_REG EQU CYREG_B0_UDB11_CTL
LIN_BUART_sRX_RxBitCounter__CONTROL_ST_REG EQU CYREG_B0_UDB11_ST_CTL
LIN_BUART_sRX_RxBitCounter__COUNT_REG EQU CYREG_B0_UDB11_CTL
LIN_BUART_sRX_RxBitCounter__COUNT_ST_REG EQU CYREG_B0_UDB11_ST_CTL
LIN_BUART_sRX_RxBitCounter__MASK_CTL_AUX_CTL_REG EQU CYREG_B0_UDB11_MSK_ACTL
LIN_BUART_sRX_RxBitCounter__PERIOD_REG EQU CYREG_B0_UDB11_MSK
LIN_BUART_sRX_RxBitCounter__PER_CTL_AUX_CTL_REG EQU CYREG_B0_UDB11_MSK_ACTL
LIN_BUART_sRX_RxShifter_u0__16BIT_A0_REG EQU CYREG_B0_UDB11_12_A0
LIN_BUART_sRX_RxShifter_u0__16BIT_A1_REG EQU CYREG_B0_UDB11_12_A1
LIN_BUART_sRX_RxShifter_u0__16BIT_D0_REG EQU CYREG_B0_UDB11_12_D0
LIN_BUART_sRX_RxShifter_u0__16BIT_D1_REG EQU CYREG_B0_UDB11_12_D1
LIN_BUART_sRX_RxShifter_u0__16BIT_DP_AUX_CTL_REG EQU CYREG_B0_UDB11_12_ACTL
LIN_BUART_sRX_RxShifter_u0__16BIT_F0_REG EQU CYREG_B0_UDB11_12_F0
LIN_BUART_sRX_RxShifter_u0__16BIT_F1_REG EQU CYREG_B0_UDB11_12_F1
LIN_BUART_sRX_RxShifter_u0__A0_A1_REG EQU CYREG_B0_UDB11_A0_A1
LIN_BUART_sRX_RxShifter_u0__A0_REG EQU CYREG_B0_UDB11_A0
LIN_BUART_sRX_RxShifter_u0__A1_REG EQU CYREG_B0_UDB11_A1
LIN_BUART_sRX_RxShifter_u0__D0_D1_REG EQU CYREG_B0_UDB11_D0_D1
LIN_BUART_sRX_RxShifter_u0__D0_REG EQU CYREG_B0_UDB11_D0
LIN_BUART_sRX_RxShifter_u0__D1_REG EQU CYREG_B0_UDB11_D1
LIN_BUART_sRX_RxShifter_u0__DP_AUX_CTL_REG EQU CYREG_B0_UDB11_ACTL
LIN_BUART_sRX_RxShifter_u0__F0_F1_REG EQU CYREG_B0_UDB11_F0_F1
LIN_BUART_sRX_RxShifter_u0__F0_REG EQU CYREG_B0_UDB11_F0
LIN_BUART_sRX_RxShifter_u0__F1_REG EQU CYREG_B0_UDB11_F1
LIN_BUART_sRX_RxShifter_u0__MSK_DP_AUX_CTL_REG EQU CYREG_B0_UDB11_MSK_ACTL
LIN_BUART_sRX_RxShifter_u0__PER_DP_AUX_CTL_REG EQU CYREG_B0_UDB11_MSK_ACTL
LIN_BUART_sRX_RxSts__16BIT_STATUS_AUX_CTL_REG EQU CYREG_B0_UDB10_11_ACTL
LIN_BUART_sRX_RxSts__16BIT_STATUS_REG EQU CYREG_B0_UDB10_11_ST
LIN_BUART_sRX_RxSts__1__MASK EQU 0x02
LIN_BUART_sRX_RxSts__1__POS EQU 1
LIN_BUART_sRX_RxSts__3__MASK EQU 0x08
LIN_BUART_sRX_RxSts__3__POS EQU 3
LIN_BUART_sRX_RxSts__4__MASK EQU 0x10
LIN_BUART_sRX_RxSts__4__POS EQU 4
LIN_BUART_sRX_RxSts__5__MASK EQU 0x20
LIN_BUART_sRX_RxSts__5__POS EQU 5
LIN_BUART_sRX_RxSts__MASK EQU 0x3A
LIN_BUART_sRX_RxSts__MASK_REG EQU CYREG_B0_UDB10_MSK
LIN_BUART_sRX_RxSts__STATUS_AUX_CTL_REG EQU CYREG_B0_UDB10_ACTL
LIN_BUART_sRX_RxSts__STATUS_REG EQU CYREG_B0_UDB10_ST
LIN_BUART_sTX_TxShifter_u0__A0_A1_REG EQU CYREG_B0_UDB15_A0_A1
LIN_BUART_sTX_TxShifter_u0__A0_REG EQU CYREG_B0_UDB15_A0
LIN_BUART_sTX_TxShifter_u0__A1_REG EQU CYREG_B0_UDB15_A1
LIN_BUART_sTX_TxShifter_u0__D0_D1_REG EQU CYREG_B0_UDB15_D0_D1
LIN_BUART_sTX_TxShifter_u0__D0_REG EQU CYREG_B0_UDB15_D0
LIN_BUART_sTX_TxShifter_u0__D1_REG EQU CYREG_B0_UDB15_D1
LIN_BUART_sTX_TxShifter_u0__DP_AUX_CTL_REG EQU CYREG_B0_UDB15_ACTL
LIN_BUART_sTX_TxShifter_u0__F0_F1_REG EQU CYREG_B0_UDB15_F0_F1
LIN_BUART_sTX_TxShifter_u0__F0_REG EQU CYREG_B0_UDB15_F0
LIN_BUART_sTX_TxShifter_u0__F1_REG EQU CYREG_B0_UDB15_F1
LIN_BUART_sTX_TxSts__0__MASK EQU 0x01
LIN_BUART_sTX_TxSts__0__POS EQU 0
LIN_BUART_sTX_TxSts__1__MASK EQU 0x02
LIN_BUART_sTX_TxSts__1__POS EQU 1
LIN_BUART_sTX_TxSts__2__MASK EQU 0x04
LIN_BUART_sTX_TxSts__2__POS EQU 2
LIN_BUART_sTX_TxSts__3__MASK EQU 0x08
LIN_BUART_sTX_TxSts__3__POS EQU 3
LIN_BUART_sTX_TxSts__MASK EQU 0x0F
LIN_BUART_sTX_TxSts__MASK_REG EQU CYREG_B0_UDB15_MSK
LIN_BUART_sTX_TxSts__STATUS_AUX_CTL_REG EQU CYREG_B0_UDB15_ACTL
LIN_BUART_sTX_TxSts__STATUS_REG EQU CYREG_B0_UDB15_ST
LIN_BUART_sTX_sCLOCK_TxBitClkGen__16BIT_A0_REG EQU CYREG_B0_UDB14_15_A0
LIN_BUART_sTX_sCLOCK_TxBitClkGen__16BIT_A1_REG EQU CYREG_B0_UDB14_15_A1
LIN_BUART_sTX_sCLOCK_TxBitClkGen__16BIT_D0_REG EQU CYREG_B0_UDB14_15_D0
LIN_BUART_sTX_sCLOCK_TxBitClkGen__16BIT_D1_REG EQU CYREG_B0_UDB14_15_D1
LIN_BUART_sTX_sCLOCK_TxBitClkGen__16BIT_DP_AUX_CTL_REG EQU CYREG_B0_UDB14_15_ACTL
LIN_BUART_sTX_sCLOCK_TxBitClkGen__16BIT_F0_REG EQU CYREG_B0_UDB14_15_F0
LIN_BUART_sTX_sCLOCK_TxBitClkGen__16BIT_F1_REG EQU CYREG_B0_UDB14_15_F1
LIN_BUART_sTX_sCLOCK_TxBitClkGen__A0_A1_REG EQU CYREG_B0_UDB14_A0_A1
LIN_BUART_sTX_sCLOCK_TxBitClkGen__A0_REG EQU CYREG_B0_UDB14_A0
LIN_BUART_sTX_sCLOCK_TxBitClkGen__A1_REG EQU CYREG_B0_UDB14_A1
LIN_BUART_sTX_sCLOCK_TxBitClkGen__D0_D1_REG EQU CYREG_B0_UDB14_D0_D1
LIN_BUART_sTX_sCLOCK_TxBitClkGen__D0_REG EQU CYREG_B0_UDB14_D0
LIN_BUART_sTX_sCLOCK_TxBitClkGen__D1_REG EQU CYREG_B0_UDB14_D1
LIN_BUART_sTX_sCLOCK_TxBitClkGen__DP_AUX_CTL_REG EQU CYREG_B0_UDB14_ACTL
LIN_BUART_sTX_sCLOCK_TxBitClkGen__F0_F1_REG EQU CYREG_B0_UDB14_F0_F1
LIN_BUART_sTX_sCLOCK_TxBitClkGen__F0_REG EQU CYREG_B0_UDB14_F0
LIN_BUART_sTX_sCLOCK_TxBitClkGen__F1_REG EQU CYREG_B0_UDB14_F1

; PS2_BUART
PS2_BUART_sRX_RxBitCounter_ST__16BIT_STATUS_AUX_CTL_REG EQU CYREG_B0_UDB08_09_ACTL
PS2_BUART_sRX_RxBitCounter_ST__16BIT_STATUS_REG EQU CYREG_B0_UDB08_09_ST
PS2_BUART_sRX_RxBitCounter_ST__MASK_REG EQU CYREG_B0_UDB08_MSK
PS2_BUART_sRX_RxBitCounter_ST__MASK_ST_AUX_CTL_REG EQU CYREG_B0_UDB08_MSK_ACTL
PS2_BUART_sRX_RxBitCounter_ST__PER_ST_AUX_CTL_REG EQU CYREG_B0_UDB08_MSK_ACTL
PS2_BUART_sRX_RxBitCounter_ST__STATUS_AUX_CTL_REG EQU CYREG_B0_UDB08_ACTL
PS2_BUART_sRX_RxBitCounter_ST__STATUS_CNT_REG EQU CYREG_B0_UDB08_ST_CTL
PS2_BUART_sRX_RxBitCounter_ST__STATUS_CONTROL_REG EQU CYREG_B0_UDB08_ST_CTL
PS2_BUART_sRX_RxBitCounter_ST__STATUS_REG EQU CYREG_B0_UDB08_ST
PS2_BUART_sRX_RxBitCounter__16BIT_CONTROL_AUX_CTL_REG EQU CYREG_B0_UDB08_09_ACTL
PS2_BUART_sRX_RxBitCounter__16BIT_CONTROL_CONTROL_REG EQU CYREG_B0_UDB08_09_CTL
PS2_BUART_sRX_RxBitCounter__16BIT_CONTROL_COUNT_REG EQU CYREG_B0_UDB08_09_CTL
PS2_BUART_sRX_RxBitCounter__16BIT_COUNT_CONTROL_REG EQU CYREG_B0_UDB08_09_CTL
PS2_BUART_sRX_RxBitCounter__16BIT_COUNT_COUNT_REG EQU CYREG_B0_UDB08_09_CTL
PS2_BUART_sRX_RxBitCounter__16BIT_MASK_MASK_REG EQU CYREG_B0_UDB08_09_MSK
PS2_BUART_sRX_RxBitCounter__16BIT_MASK_PERIOD_REG EQU CYREG_B0_UDB08_09_MSK
PS2_BUART_sRX_RxBitCounter__16BIT_PERIOD_MASK_REG EQU CYREG_B0_UDB08_09_MSK
PS2_BUART_sRX_RxBitCounter__16BIT_PERIOD_PERIOD_REG EQU CYREG_B0_UDB08_09_MSK
PS2_BUART_sRX_RxBitCounter__CONTROL_AUX_CTL_REG EQU CYREG_B0_UDB08_ACTL
PS2_BUART_sRX_RxBitCounter__CONTROL_REG EQU CYREG_B0_UDB08_CTL
PS2_BUART_sRX_RxBitCounter__CONTROL_ST_REG EQU CYREG_B0_UDB08_ST_CTL
PS2_BUART_sRX_RxBitCounter__COUNT_REG EQU CYREG_B0_UDB08_CTL
PS2_BUART_sRX_RxBitCounter__COUNT_ST_REG EQU CYREG_B0_UDB08_ST_CTL
PS2_BUART_sRX_RxBitCounter__MASK_CTL_AUX_CTL_REG EQU CYREG_B0_UDB08_MSK_ACTL
PS2_BUART_sRX_RxBitCounter__PERIOD_REG EQU CYREG_B0_UDB08_MSK
PS2_BUART_sRX_RxBitCounter__PER_CTL_AUX_CTL_REG EQU CYREG_B0_UDB08_MSK_ACTL
PS2_BUART_sRX_RxShifter_u0__A0_A1_REG EQU CYREG_B1_UDB09_A0_A1
PS2_BUART_sRX_RxShifter_u0__A0_REG EQU CYREG_B1_UDB09_A0
PS2_BUART_sRX_RxShifter_u0__A1_REG EQU CYREG_B1_UDB09_A1
PS2_BUART_sRX_RxShifter_u0__D0_D1_REG EQU CYREG_B1_UDB09_D0_D1
PS2_BUART_sRX_RxShifter_u0__D0_REG EQU CYREG_B1_UDB09_D0
PS2_BUART_sRX_RxShifter_u0__D1_REG EQU CYREG_B1_UDB09_D1
PS2_BUART_sRX_RxShifter_u0__DP_AUX_CTL_REG EQU CYREG_B1_UDB09_ACTL
PS2_BUART_sRX_RxShifter_u0__F0_F1_REG EQU CYREG_B1_UDB09_F0_F1
PS2_BUART_sRX_RxShifter_u0__F0_REG EQU CYREG_B1_UDB09_F0
PS2_BUART_sRX_RxShifter_u0__F1_REG EQU CYREG_B1_UDB09_F1
PS2_BUART_sRX_RxSts__3__MASK EQU 0x08
PS2_BUART_sRX_RxSts__3__POS EQU 3
PS2_BUART_sRX_RxSts__4__MASK EQU 0x10
PS2_BUART_sRX_RxSts__4__POS EQU 4
PS2_BUART_sRX_RxSts__5__MASK EQU 0x20
PS2_BUART_sRX_RxSts__5__POS EQU 5
PS2_BUART_sRX_RxSts__MASK EQU 0x38
PS2_BUART_sRX_RxSts__MASK_REG EQU CYREG_B1_UDB09_MSK
PS2_BUART_sRX_RxSts__STATUS_AUX_CTL_REG EQU CYREG_B1_UDB09_ACTL
PS2_BUART_sRX_RxSts__STATUS_REG EQU CYREG_B1_UDB09_ST

; Clock_1
Clock_1__CFG0 EQU CYREG_CLKDIST_DCFG4_CFG0
Clock_1__CFG1 EQU CYREG_CLKDIST_DCFG4_CFG1
Clock_1__CFG2 EQU CYREG_CLKDIST_DCFG4_CFG2
Clock_1__CFG2_SRC_SEL_MASK EQU 0x07
Clock_1__INDEX EQU 0x04
Clock_1__PM_ACT_CFG EQU CYREG_PM_ACT_CFG2
Clock_1__PM_ACT_MSK EQU 0x10
Clock_1__PM_STBY_CFG EQU CYREG_PM_STBY_CFG2
Clock_1__PM_STBY_MSK EQU 0x10

; PS2_IN
PS2_IN__0__MASK EQU 0x02
PS2_IN__0__PC EQU CYREG_PRT6_PC1
PS2_IN__0__PORT EQU 6
PS2_IN__0__SHIFT EQU 1
PS2_IN__AG EQU CYREG_PRT6_AG
PS2_IN__AMUX EQU CYREG_PRT6_AMUX
PS2_IN__BIE EQU CYREG_PRT6_BIE
PS2_IN__BIT_MASK EQU CYREG_PRT6_BIT_MASK
PS2_IN__BYP EQU CYREG_PRT6_BYP
PS2_IN__CTL EQU CYREG_PRT6_CTL
PS2_IN__DM0 EQU CYREG_PRT6_DM0
PS2_IN__DM1 EQU CYREG_PRT6_DM1
PS2_IN__DM2 EQU CYREG_PRT6_DM2
PS2_IN__DR EQU CYREG_PRT6_DR
PS2_IN__INP_DIS EQU CYREG_PRT6_INP_DIS
PS2_IN__LCD_COM_SEG EQU CYREG_PRT6_LCD_COM_SEG
PS2_IN__LCD_EN EQU CYREG_PRT6_LCD_EN
PS2_IN__MASK EQU 0x02
PS2_IN__PORT EQU 6
PS2_IN__PRT EQU CYREG_PRT6_PRT
PS2_IN__PRTDSI__CAPS_SEL EQU CYREG_PRT6_CAPS_SEL
PS2_IN__PRTDSI__DBL_SYNC_IN EQU CYREG_PRT6_DBL_SYNC_IN
PS2_IN__PRTDSI__OE_SEL0 EQU CYREG_PRT6_OE_SEL0
PS2_IN__PRTDSI__OE_SEL1 EQU CYREG_PRT6_OE_SEL1
PS2_IN__PRTDSI__OUT_SEL0 EQU CYREG_PRT6_OUT_SEL0
PS2_IN__PRTDSI__OUT_SEL1 EQU CYREG_PRT6_OUT_SEL1
PS2_IN__PRTDSI__SYNC_OUT EQU CYREG_PRT6_SYNC_OUT
PS2_IN__PS EQU CYREG_PRT6_PS
PS2_IN__SHIFT EQU 1
PS2_IN__SLW EQU CYREG_PRT6_SLW

; air_1
air_1__0__MASK EQU 0x01
air_1__0__PC EQU CYREG_PRT0_PC0
air_1__0__PORT EQU 0
air_1__0__SHIFT EQU 0
air_1__AG EQU CYREG_PRT0_AG
air_1__AMUX EQU CYREG_PRT0_AMUX
air_1__BIE EQU CYREG_PRT0_BIE
air_1__BIT_MASK EQU CYREG_PRT0_BIT_MASK
air_1__BYP EQU CYREG_PRT0_BYP
air_1__CTL EQU CYREG_PRT0_CTL
air_1__DM0 EQU CYREG_PRT0_DM0
air_1__DM1 EQU CYREG_PRT0_DM1
air_1__DM2 EQU CYREG_PRT0_DM2
air_1__DR EQU CYREG_PRT0_DR
air_1__INP_DIS EQU CYREG_PRT0_INP_DIS
air_1__LCD_COM_SEG EQU CYREG_PRT0_LCD_COM_SEG
air_1__LCD_EN EQU CYREG_PRT0_LCD_EN
air_1__MASK EQU 0x01
air_1__PORT EQU 0
air_1__PRT EQU CYREG_PRT0_PRT
air_1__PRTDSI__CAPS_SEL EQU CYREG_PRT0_CAPS_SEL
air_1__PRTDSI__DBL_SYNC_IN EQU CYREG_PRT0_DBL_SYNC_IN
air_1__PRTDSI__OE_SEL0 EQU CYREG_PRT0_OE_SEL0
air_1__PRTDSI__OE_SEL1 EQU CYREG_PRT0_OE_SEL1
air_1__PRTDSI__OUT_SEL0 EQU CYREG_PRT0_OUT_SEL0
air_1__PRTDSI__OUT_SEL1 EQU CYREG_PRT0_OUT_SEL1
air_1__PRTDSI__SYNC_OUT EQU CYREG_PRT0_SYNC_OUT
air_1__PS EQU CYREG_PRT0_PS
air_1__SHIFT EQU 0
air_1__SLW EQU CYREG_PRT0_SLW

; air_2
air_2__0__MASK EQU 0x02
air_2__0__PC EQU CYREG_PRT0_PC1
air_2__0__PORT EQU 0
air_2__0__SHIFT EQU 1
air_2__AG EQU CYREG_PRT0_AG
air_2__AMUX EQU CYREG_PRT0_AMUX
air_2__BIE EQU CYREG_PRT0_BIE
air_2__BIT_MASK EQU CYREG_PRT0_BIT_MASK
air_2__BYP EQU CYREG_PRT0_BYP
air_2__CTL EQU CYREG_PRT0_CTL
air_2__DM0 EQU CYREG_PRT0_DM0
air_2__DM1 EQU CYREG_PRT0_DM1
air_2__DM2 EQU CYREG_PRT0_DM2
air_2__DR EQU CYREG_PRT0_DR
air_2__INP_DIS EQU CYREG_PRT0_INP_DIS
air_2__LCD_COM_SEG EQU CYREG_PRT0_LCD_COM_SEG
air_2__LCD_EN EQU CYREG_PRT0_LCD_EN
air_2__MASK EQU 0x02
air_2__PORT EQU 0
air_2__PRT EQU CYREG_PRT0_PRT
air_2__PRTDSI__CAPS_SEL EQU CYREG_PRT0_CAPS_SEL
air_2__PRTDSI__DBL_SYNC_IN EQU CYREG_PRT0_DBL_SYNC_IN
air_2__PRTDSI__OE_SEL0 EQU CYREG_PRT0_OE_SEL0
air_2__PRTDSI__OE_SEL1 EQU CYREG_PRT0_OE_SEL1
air_2__PRTDSI__OUT_SEL0 EQU CYREG_PRT0_OUT_SEL0
air_2__PRTDSI__OUT_SEL1 EQU CYREG_PRT0_OUT_SEL1
air_2__PRTDSI__SYNC_OUT EQU CYREG_PRT0_SYNC_OUT
air_2__PS EQU CYREG_PRT0_PS
air_2__SHIFT EQU 1
air_2__SLW EQU CYREG_PRT0_SLW

; air_3
air_3__0__MASK EQU 0x04
air_3__0__PC EQU CYREG_PRT0_PC2
air_3__0__PORT EQU 0
air_3__0__SHIFT EQU 2
air_3__AG EQU CYREG_PRT0_AG
air_3__AMUX EQU CYREG_PRT0_AMUX
air_3__BIE EQU CYREG_PRT0_BIE
air_3__BIT_MASK EQU CYREG_PRT0_BIT_MASK
air_3__BYP EQU CYREG_PRT0_BYP
air_3__CTL EQU CYREG_PRT0_CTL
air_3__DM0 EQU CYREG_PRT0_DM0
air_3__DM1 EQU CYREG_PRT0_DM1
air_3__DM2 EQU CYREG_PRT0_DM2
air_3__DR EQU CYREG_PRT0_DR
air_3__INP_DIS EQU CYREG_PRT0_INP_DIS
air_3__LCD_COM_SEG EQU CYREG_PRT0_LCD_COM_SEG
air_3__LCD_EN EQU CYREG_PRT0_LCD_EN
air_3__MASK EQU 0x04
air_3__PORT EQU 0
air_3__PRT EQU CYREG_PRT0_PRT
air_3__PRTDSI__CAPS_SEL EQU CYREG_PRT0_CAPS_SEL
air_3__PRTDSI__DBL_SYNC_IN EQU CYREG_PRT0_DBL_SYNC_IN
air_3__PRTDSI__OE_SEL0 EQU CYREG_PRT0_OE_SEL0
air_3__PRTDSI__OE_SEL1 EQU CYREG_PRT0_OE_SEL1
air_3__PRTDSI__OUT_SEL0 EQU CYREG_PRT0_OUT_SEL0
air_3__PRTDSI__OUT_SEL1 EQU CYREG_PRT0_OUT_SEL1
air_3__PRTDSI__SYNC_OUT EQU CYREG_PRT0_SYNC_OUT
air_3__PS EQU CYREG_PRT0_PS
air_3__SHIFT EQU 2
air_3__SLW EQU CYREG_PRT0_SLW

; air_4
air_4__0__MASK EQU 0x08
air_4__0__PC EQU CYREG_PRT0_PC3
air_4__0__PORT EQU 0
air_4__0__SHIFT EQU 3
air_4__AG EQU CYREG_PRT0_AG
air_4__AMUX EQU CYREG_PRT0_AMUX
air_4__BIE EQU CYREG_PRT0_BIE
air_4__BIT_MASK EQU CYREG_PRT0_BIT_MASK
air_4__BYP EQU CYREG_PRT0_BYP
air_4__CTL EQU CYREG_PRT0_CTL
air_4__DM0 EQU CYREG_PRT0_DM0
air_4__DM1 EQU CYREG_PRT0_DM1
air_4__DM2 EQU CYREG_PRT0_DM2
air_4__DR EQU CYREG_PRT0_DR
air_4__INP_DIS EQU CYREG_PRT0_INP_DIS
air_4__LCD_COM_SEG EQU CYREG_PRT0_LCD_COM_SEG
air_4__LCD_EN EQU CYREG_PRT0_LCD_EN
air_4__MASK EQU 0x08
air_4__PORT EQU 0
air_4__PRT EQU CYREG_PRT0_PRT
air_4__PRTDSI__CAPS_SEL EQU CYREG_PRT0_CAPS_SEL
air_4__PRTDSI__DBL_SYNC_IN EQU CYREG_PRT0_DBL_SYNC_IN
air_4__PRTDSI__OE_SEL0 EQU CYREG_PRT0_OE_SEL0
air_4__PRTDSI__OE_SEL1 EQU CYREG_PRT0_OE_SEL1
air_4__PRTDSI__OUT_SEL0 EQU CYREG_PRT0_OUT_SEL0
air_4__PRTDSI__OUT_SEL1 EQU CYREG_PRT0_OUT_SEL1
air_4__PRTDSI__SYNC_OUT EQU CYREG_PRT0_SYNC_OUT
air_4__PS EQU CYREG_PRT0_PS
air_4__SHIFT EQU 3
air_4__SLW EQU CYREG_PRT0_SLW

; air_5
air_5__0__MASK EQU 0x10
air_5__0__PC EQU CYREG_PRT0_PC4
air_5__0__PORT EQU 0
air_5__0__SHIFT EQU 4
air_5__AG EQU CYREG_PRT0_AG
air_5__AMUX EQU CYREG_PRT0_AMUX
air_5__BIE EQU CYREG_PRT0_BIE
air_5__BIT_MASK EQU CYREG_PRT0_BIT_MASK
air_5__BYP EQU CYREG_PRT0_BYP
air_5__CTL EQU CYREG_PRT0_CTL
air_5__DM0 EQU CYREG_PRT0_DM0
air_5__DM1 EQU CYREG_PRT0_DM1
air_5__DM2 EQU CYREG_PRT0_DM2
air_5__DR EQU CYREG_PRT0_DR
air_5__INP_DIS EQU CYREG_PRT0_INP_DIS
air_5__LCD_COM_SEG EQU CYREG_PRT0_LCD_COM_SEG
air_5__LCD_EN EQU CYREG_PRT0_LCD_EN
air_5__MASK EQU 0x10
air_5__PORT EQU 0
air_5__PRT EQU CYREG_PRT0_PRT
air_5__PRTDSI__CAPS_SEL EQU CYREG_PRT0_CAPS_SEL
air_5__PRTDSI__DBL_SYNC_IN EQU CYREG_PRT0_DBL_SYNC_IN
air_5__PRTDSI__OE_SEL0 EQU CYREG_PRT0_OE_SEL0
air_5__PRTDSI__OE_SEL1 EQU CYREG_PRT0_OE_SEL1
air_5__PRTDSI__OUT_SEL0 EQU CYREG_PRT0_OUT_SEL0
air_5__PRTDSI__OUT_SEL1 EQU CYREG_PRT0_OUT_SEL1
air_5__PRTDSI__SYNC_OUT EQU CYREG_PRT0_SYNC_OUT
air_5__PS EQU CYREG_PRT0_PS
air_5__SHIFT EQU 4
air_5__SLW EQU CYREG_PRT0_SLW

; air_6
air_6__0__MASK EQU 0x20
air_6__0__PC EQU CYREG_PRT0_PC5
air_6__0__PORT EQU 0
air_6__0__SHIFT EQU 5
air_6__AG EQU CYREG_PRT0_AG
air_6__AMUX EQU CYREG_PRT0_AMUX
air_6__BIE EQU CYREG_PRT0_BIE
air_6__BIT_MASK EQU CYREG_PRT0_BIT_MASK
air_6__BYP EQU CYREG_PRT0_BYP
air_6__CTL EQU CYREG_PRT0_CTL
air_6__DM0 EQU CYREG_PRT0_DM0
air_6__DM1 EQU CYREG_PRT0_DM1
air_6__DM2 EQU CYREG_PRT0_DM2
air_6__DR EQU CYREG_PRT0_DR
air_6__INP_DIS EQU CYREG_PRT0_INP_DIS
air_6__LCD_COM_SEG EQU CYREG_PRT0_LCD_COM_SEG
air_6__LCD_EN EQU CYREG_PRT0_LCD_EN
air_6__MASK EQU 0x20
air_6__PORT EQU 0
air_6__PRT EQU CYREG_PRT0_PRT
air_6__PRTDSI__CAPS_SEL EQU CYREG_PRT0_CAPS_SEL
air_6__PRTDSI__DBL_SYNC_IN EQU CYREG_PRT0_DBL_SYNC_IN
air_6__PRTDSI__OE_SEL0 EQU CYREG_PRT0_OE_SEL0
air_6__PRTDSI__OE_SEL1 EQU CYREG_PRT0_OE_SEL1
air_6__PRTDSI__OUT_SEL0 EQU CYREG_PRT0_OUT_SEL0
air_6__PRTDSI__OUT_SEL1 EQU CYREG_PRT0_OUT_SEL1
air_6__PRTDSI__SYNC_OUT EQU CYREG_PRT0_SYNC_OUT
air_6__PS EQU CYREG_PRT0_PS
air_6__SHIFT EQU 5
air_6__SLW EQU CYREG_PRT0_SLW

; air_7
air_7__0__MASK EQU 0x40
air_7__0__PC EQU CYREG_PRT0_PC6
air_7__0__PORT EQU 0
air_7__0__SHIFT EQU 6
air_7__AG EQU CYREG_PRT0_AG
air_7__AMUX EQU CYREG_PRT0_AMUX
air_7__BIE EQU CYREG_PRT0_BIE
air_7__BIT_MASK EQU CYREG_PRT0_BIT_MASK
air_7__BYP EQU CYREG_PRT0_BYP
air_7__CTL EQU CYREG_PRT0_CTL
air_7__DM0 EQU CYREG_PRT0_DM0
air_7__DM1 EQU CYREG_PRT0_DM1
air_7__DM2 EQU CYREG_PRT0_DM2
air_7__DR EQU CYREG_PRT0_DR
air_7__INP_DIS EQU CYREG_PRT0_INP_DIS
air_7__LCD_COM_SEG EQU CYREG_PRT0_LCD_COM_SEG
air_7__LCD_EN EQU CYREG_PRT0_LCD_EN
air_7__MASK EQU 0x40
air_7__PORT EQU 0
air_7__PRT EQU CYREG_PRT0_PRT
air_7__PRTDSI__CAPS_SEL EQU CYREG_PRT0_CAPS_SEL
air_7__PRTDSI__DBL_SYNC_IN EQU CYREG_PRT0_DBL_SYNC_IN
air_7__PRTDSI__OE_SEL0 EQU CYREG_PRT0_OE_SEL0
air_7__PRTDSI__OE_SEL1 EQU CYREG_PRT0_OE_SEL1
air_7__PRTDSI__OUT_SEL0 EQU CYREG_PRT0_OUT_SEL0
air_7__PRTDSI__OUT_SEL1 EQU CYREG_PRT0_OUT_SEL1
air_7__PRTDSI__SYNC_OUT EQU CYREG_PRT0_SYNC_OUT
air_7__PS EQU CYREG_PRT0_PS
air_7__SHIFT EQU 6
air_7__SLW EQU CYREG_PRT0_SLW

; air_8
air_8__0__MASK EQU 0x80
air_8__0__PC EQU CYREG_PRT0_PC7
air_8__0__PORT EQU 0
air_8__0__SHIFT EQU 7
air_8__AG EQU CYREG_PRT0_AG
air_8__AMUX EQU CYREG_PRT0_AMUX
air_8__BIE EQU CYREG_PRT0_BIE
air_8__BIT_MASK EQU CYREG_PRT0_BIT_MASK
air_8__BYP EQU CYREG_PRT0_BYP
air_8__CTL EQU CYREG_PRT0_CTL
air_8__DM0 EQU CYREG_PRT0_DM0
air_8__DM1 EQU CYREG_PRT0_DM1
air_8__DM2 EQU CYREG_PRT0_DM2
air_8__DR EQU CYREG_PRT0_DR
air_8__INP_DIS EQU CYREG_PRT0_INP_DIS
air_8__LCD_COM_SEG EQU CYREG_PRT0_LCD_COM_SEG
air_8__LCD_EN EQU CYREG_PRT0_LCD_EN
air_8__MASK EQU 0x80
air_8__PORT EQU 0
air_8__PRT EQU CYREG_PRT0_PRT
air_8__PRTDSI__CAPS_SEL EQU CYREG_PRT0_CAPS_SEL
air_8__PRTDSI__DBL_SYNC_IN EQU CYREG_PRT0_DBL_SYNC_IN
air_8__PRTDSI__OE_SEL0 EQU CYREG_PRT0_OE_SEL0
air_8__PRTDSI__OE_SEL1 EQU CYREG_PRT0_OE_SEL1
air_8__PRTDSI__OUT_SEL0 EQU CYREG_PRT0_OUT_SEL0
air_8__PRTDSI__OUT_SEL1 EQU CYREG_PRT0_OUT_SEL1
air_8__PRTDSI__SYNC_OUT EQU CYREG_PRT0_SYNC_OUT
air_8__PS EQU CYREG_PRT0_PS
air_8__SHIFT EQU 7
air_8__SLW EQU CYREG_PRT0_SLW

; isr_1
isr_1__ES2_PATCH EQU 0
isr_1__INTC_CLR_EN_REG EQU CYREG_INTC_CLR_EN0
isr_1__INTC_CLR_PD_REG EQU CYREG_INTC_CLR_PD0
isr_1__INTC_MASK EQU 0x10
isr_1__INTC_NUMBER EQU 4
isr_1__INTC_PRIOR_NUM EQU 7
isr_1__INTC_PRIOR_REG EQU CYREG_INTC_PRIOR4
isr_1__INTC_SET_EN_REG EQU CYREG_INTC_SET_EN0
isr_1__INTC_SET_PD_REG EQU CYREG_INTC_SET_PD0
isr_1__INTC_VECT EQU (CYREG_INTC_VECT_MBASE+0x08)

; Rx_1
Rx_1__0__MASK EQU 0x01
Rx_1__0__PC EQU CYREG_PRT5_PC0
Rx_1__0__PORT EQU 5
Rx_1__0__SHIFT EQU 0
Rx_1__AG EQU CYREG_PRT5_AG
Rx_1__AMUX EQU CYREG_PRT5_AMUX
Rx_1__BIE EQU CYREG_PRT5_BIE
Rx_1__BIT_MASK EQU CYREG_PRT5_BIT_MASK
Rx_1__BYP EQU CYREG_PRT5_BYP
Rx_1__CTL EQU CYREG_PRT5_CTL
Rx_1__DM0 EQU CYREG_PRT5_DM0
Rx_1__DM1 EQU CYREG_PRT5_DM1
Rx_1__DM2 EQU CYREG_PRT5_DM2
Rx_1__DR EQU CYREG_PRT5_DR
Rx_1__INP_DIS EQU CYREG_PRT5_INP_DIS
Rx_1__LCD_COM_SEG EQU CYREG_PRT5_LCD_COM_SEG
Rx_1__LCD_EN EQU CYREG_PRT5_LCD_EN
Rx_1__MASK EQU 0x01
Rx_1__PORT EQU 5
Rx_1__PRT EQU CYREG_PRT5_PRT
Rx_1__PRTDSI__CAPS_SEL EQU CYREG_PRT5_CAPS_SEL
Rx_1__PRTDSI__DBL_SYNC_IN EQU CYREG_PRT5_DBL_SYNC_IN
Rx_1__PRTDSI__OE_SEL0 EQU CYREG_PRT5_OE_SEL0
Rx_1__PRTDSI__OE_SEL1 EQU CYREG_PRT5_OE_SEL1
Rx_1__PRTDSI__OUT_SEL0 EQU CYREG_PRT5_OUT_SEL0
Rx_1__PRTDSI__OUT_SEL1 EQU CYREG_PRT5_OUT_SEL1
Rx_1__PRTDSI__SYNC_OUT EQU CYREG_PRT5_SYNC_OUT
Rx_1__PS EQU CYREG_PRT5_PS
Rx_1__SHIFT EQU 0
Rx_1__SLW EQU CYREG_PRT5_SLW

; Tx_1
Tx_1__0__MASK EQU 0x10
Tx_1__0__PC EQU CYREG_PRT5_PC4
Tx_1__0__PORT EQU 5
Tx_1__0__SHIFT EQU 4
Tx_1__AG EQU CYREG_PRT5_AG
Tx_1__AMUX EQU CYREG_PRT5_AMUX
Tx_1__BIE EQU CYREG_PRT5_BIE
Tx_1__BIT_MASK EQU CYREG_PRT5_BIT_MASK
Tx_1__BYP EQU CYREG_PRT5_BYP
Tx_1__CTL EQU CYREG_PRT5_CTL
Tx_1__DM0 EQU CYREG_PRT5_DM0
Tx_1__DM1 EQU CYREG_PRT5_DM1
Tx_1__DM2 EQU CYREG_PRT5_DM2
Tx_1__DR EQU CYREG_PRT5_DR
Tx_1__INP_DIS EQU CYREG_PRT5_INP_DIS
Tx_1__LCD_COM_SEG EQU CYREG_PRT5_LCD_COM_SEG
Tx_1__LCD_EN EQU CYREG_PRT5_LCD_EN
Tx_1__MASK EQU 0x10
Tx_1__PORT EQU 5
Tx_1__PRT EQU CYREG_PRT5_PRT
Tx_1__PRTDSI__CAPS_SEL EQU CYREG_PRT5_CAPS_SEL
Tx_1__PRTDSI__DBL_SYNC_IN EQU CYREG_PRT5_DBL_SYNC_IN
Tx_1__PRTDSI__OE_SEL0 EQU CYREG_PRT5_OE_SEL0
Tx_1__PRTDSI__OE_SEL1 EQU CYREG_PRT5_OE_SEL1
Tx_1__PRTDSI__OUT_SEL0 EQU CYREG_PRT5_OUT_SEL0
Tx_1__PRTDSI__OUT_SEL1 EQU CYREG_PRT5_OUT_SEL1
Tx_1__PRTDSI__SYNC_OUT EQU CYREG_PRT5_SYNC_OUT
Tx_1__PS EQU CYREG_PRT5_PS
Tx_1__SHIFT EQU 4
Tx_1__SLW EQU CYREG_PRT5_SLW

; Tx_2
Tx_2__0__MASK EQU 0x20
Tx_2__0__PC EQU CYREG_PRT2_PC5
Tx_2__0__PORT EQU 2
Tx_2__0__SHIFT EQU 5
Tx_2__AG EQU CYREG_PRT2_AG
Tx_2__AMUX EQU CYREG_PRT2_AMUX
Tx_2__BIE EQU CYREG_PRT2_BIE
Tx_2__BIT_MASK EQU CYREG_PRT2_BIT_MASK
Tx_2__BYP EQU CYREG_PRT2_BYP
Tx_2__CTL EQU CYREG_PRT2_CTL
Tx_2__DM0 EQU CYREG_PRT2_DM0
Tx_2__DM1 EQU CYREG_PRT2_DM1
Tx_2__DM2 EQU CYREG_PRT2_DM2
Tx_2__DR EQU CYREG_PRT2_DR
Tx_2__INP_DIS EQU CYREG_PRT2_INP_DIS
Tx_2__LCD_COM_SEG EQU CYREG_PRT2_LCD_COM_SEG
Tx_2__LCD_EN EQU CYREG_PRT2_LCD_EN
Tx_2__MASK EQU 0x20
Tx_2__PORT EQU 2
Tx_2__PRT EQU CYREG_PRT2_PRT
Tx_2__PRTDSI__CAPS_SEL EQU CYREG_PRT2_CAPS_SEL
Tx_2__PRTDSI__DBL_SYNC_IN EQU CYREG_PRT2_DBL_SYNC_IN
Tx_2__PRTDSI__OE_SEL0 EQU CYREG_PRT2_OE_SEL0
Tx_2__PRTDSI__OE_SEL1 EQU CYREG_PRT2_OE_SEL1
Tx_2__PRTDSI__OUT_SEL0 EQU CYREG_PRT2_OUT_SEL0
Tx_2__PRTDSI__OUT_SEL1 EQU CYREG_PRT2_OUT_SEL1
Tx_2__PRTDSI__SYNC_OUT EQU CYREG_PRT2_SYNC_OUT
Tx_2__PS EQU CYREG_PRT2_PS
Tx_2__SHIFT EQU 5
Tx_2__SLW EQU CYREG_PRT2_SLW

; Miscellaneous
; -- WARNING: define names containing LEOPARD or PANTHER are deprecated and will be removed in a future release
CYDEV_DEBUGGING_DPS_SWD_SWV EQU 6
CYDEV_CONFIG_UNUSED_IO_AllowButWarn EQU 0
CYDEV_CONFIGURATION_MODE_COMPRESSED EQU 0
CYDEV_CONFIG_FASTBOOT_ENABLED EQU 1
CYDEV_CHIP_REV_LEOPARD_PRODUCTION EQU 3
CYDEV_CHIP_REVISION_3A_PRODUCTION EQU 3
CYDEV_CHIP_MEMBER_3A EQU 1
CYDEV_CHIP_FAMILY_PSOC3 EQU 1
CYDEV_CHIP_DIE_LEOPARD EQU 1
CYDEV_CHIP_DIE_EXPECT EQU CYDEV_CHIP_DIE_LEOPARD
BCLK__BUS_CLK__HZ EQU 48000000
BCLK__BUS_CLK__KHZ EQU 48000
BCLK__BUS_CLK__MHZ EQU 48
CYDEV_CHIP_DIE_ACTUAL EQU CYDEV_CHIP_DIE_EXPECT
CYDEV_CHIP_DIE_PANTHER EQU 3
CYDEV_CHIP_DIE_PSOC4A EQU 2
CYDEV_CHIP_DIE_PSOC5LP EQU 4
CYDEV_CHIP_DIE_UNKNOWN EQU 0
CYDEV_CHIP_FAMILY_PSOC4 EQU 2
CYDEV_CHIP_FAMILY_PSOC5 EQU 3
CYDEV_CHIP_FAMILY_UNKNOWN EQU 0
CYDEV_CHIP_FAMILY_USED EQU CYDEV_CHIP_FAMILY_PSOC3
CYDEV_CHIP_JTAG_ID EQU 0x1E09E069
CYDEV_CHIP_MEMBER_4A EQU 2
CYDEV_CHIP_MEMBER_5A EQU 3
CYDEV_CHIP_MEMBER_5B EQU 4
CYDEV_CHIP_MEMBER_UNKNOWN EQU 0
CYDEV_CHIP_MEMBER_USED EQU CYDEV_CHIP_MEMBER_3A
CYDEV_CHIP_REVISION_3A_ES1 EQU 0
CYDEV_CHIP_REVISION_3A_ES2 EQU 1
CYDEV_CHIP_REVISION_3A_ES3 EQU 3
CYDEV_CHIP_REVISION_4A_ES0 EQU 17
CYDEV_CHIP_REVISION_4A_PRODUCTION EQU 17
CYDEV_CHIP_REVISION_5A_ES0 EQU 0
CYDEV_CHIP_REVISION_5A_ES1 EQU 1
CYDEV_CHIP_REVISION_5A_PRODUCTION EQU 1
CYDEV_CHIP_REVISION_5B_ES0 EQU 0
CYDEV_CHIP_REVISION_5B_PRODUCTION EQU 0
CYDEV_CHIP_REVISION_USED EQU CYDEV_CHIP_REVISION_3A_PRODUCTION
CYDEV_CHIP_REV_EXPECT EQU CYDEV_CHIP_REV_LEOPARD_PRODUCTION
CYDEV_CHIP_REV_LEOPARD_ES1 EQU 0
CYDEV_CHIP_REV_LEOPARD_ES2 EQU 1
CYDEV_CHIP_REV_LEOPARD_ES3 EQU 3
CYDEV_CHIP_REV_PANTHER_ES0 EQU 0
CYDEV_CHIP_REV_PANTHER_ES1 EQU 1
CYDEV_CHIP_REV_PANTHER_PRODUCTION EQU 1
CYDEV_CHIP_REV_PSOC4A_ES0 EQU 17
CYDEV_CHIP_REV_PSOC4A_PRODUCTION EQU 17
CYDEV_CHIP_REV_PSOC5LP_ES0 EQU 0
CYDEV_CHIP_REV_PSOC5LP_PRODUCTION EQU 0
CYDEV_CONFIGURATION_CLEAR_SRAM EQU 1
CYDEV_CONFIGURATION_COMPRESSED EQU 1
CYDEV_CONFIGURATION_DMA EQU 0
CYDEV_CONFIGURATION_ECC EQU 1
CYDEV_CONFIGURATION_IMOENABLED EQU CYDEV_CONFIG_FASTBOOT_ENABLED
CYDEV_CONFIGURATION_MODE EQU CYDEV_CONFIGURATION_MODE_COMPRESSED
CYDEV_CONFIGURATION_MODE_DMA EQU 2
CYDEV_CONFIGURATION_MODE_UNCOMPRESSED EQU 1
CYDEV_CONFIG_UNUSED_IO EQU CYDEV_CONFIG_UNUSED_IO_AllowButWarn
CYDEV_CONFIG_UNUSED_IO_AllowWithInfo EQU 1
CYDEV_CONFIG_UNUSED_IO_Disallowed EQU 2
CYDEV_DEBUGGING_DPS EQU CYDEV_DEBUGGING_DPS_SWD_SWV
CYDEV_DEBUGGING_DPS_Disable EQU 3
CYDEV_DEBUGGING_DPS_JTAG_4 EQU 1
CYDEV_DEBUGGING_DPS_JTAG_5 EQU 0
CYDEV_DEBUGGING_DPS_SWD EQU 2
CYDEV_DEBUGGING_ENABLE EQU 1
CYDEV_DEBUGGING_XRES EQU 0
CYDEV_DEBUG_ENABLE_MASK EQU 0x01
CYDEV_DEBUG_ENABLE_REGISTER EQU CYREG_MLOGIC_DEBUG
CYDEV_DMA_CHANNELS_AVAILABLE EQU 24
CYDEV_ECC_ENABLE EQU 0
CYDEV_INSTRUCT_CACHE_ENABLED EQU 1
CYDEV_INTR_RISING EQU 0x000000FF
CYDEV_PROJ_TYPE EQU 0
CYDEV_PROJ_TYPE_BOOTLOADER EQU 1
CYDEV_PROJ_TYPE_LOADABLE EQU 2
CYDEV_PROJ_TYPE_MULTIAPPBOOTLOADER EQU 3
CYDEV_PROJ_TYPE_STANDARD EQU 0
CYDEV_PROTECTION_ENABLE EQU 0
CYDEV_VARIABLE_VDDA EQU 0
CYDEV_VDDA LIT '5.0'
CYDEV_VDDA_MV EQU 5000
CYDEV_VDDD LIT '5.0'
CYDEV_VDDD_MV EQU 5000
CYDEV_VDDIO0 LIT '5.0'
CYDEV_VDDIO0_MV EQU 5000
CYDEV_VDDIO1 LIT '5.0'
CYDEV_VDDIO1_MV EQU 5000
CYDEV_VDDIO2 LIT '5.0'
CYDEV_VDDIO2_MV EQU 5000
CYDEV_VDDIO3 LIT '5.0'
CYDEV_VDDIO3_MV EQU 5000
CYDEV_VIO0 EQU 5
CYDEV_VIO0_MV EQU 5000
CYDEV_VIO1 EQU 5
CYDEV_VIO1_MV EQU 5000
CYDEV_VIO2 EQU 5
CYDEV_VIO2_MV EQU 5000
CYDEV_VIO3 EQU 5
CYDEV_VIO3_MV EQU 5000
DMA_CHANNELS_USED__MASK0 EQU 0x00000000
CYDEV_BOOTLOADER_ENABLE EQU 0

#endif /* INCLUDED_CYFITTERKEIL_INC */
