;  Generated by PSoC Designer 5.4.2946
;
; x_a_low address and mask equates
x_a_low_Data_ADDR:	equ	0h
x_a_low_DriveMode_0_ADDR:	equ	100h
x_a_low_DriveMode_1_ADDR:	equ	101h
x_a_low_DriveMode_2_ADDR:	equ	3h
x_a_low_GlobalSelect_ADDR:	equ	2h
x_a_low_IntCtrl_0_ADDR:	equ	102h
x_a_low_IntCtrl_1_ADDR:	equ	103h
x_a_low_IntEn_ADDR:	equ	1h
x_a_low_MASK:	equ	1h
; x_b_low address and mask equates
x_b_low_Data_ADDR:	equ	0h
x_b_low_DriveMode_0_ADDR:	equ	100h
x_b_low_DriveMode_1_ADDR:	equ	101h
x_b_low_DriveMode_2_ADDR:	equ	3h
x_b_low_GlobalSelect_ADDR:	equ	2h
x_b_low_IntCtrl_0_ADDR:	equ	102h
x_b_low_IntCtrl_1_ADDR:	equ	103h
x_b_low_IntEn_ADDR:	equ	1h
x_b_low_MASK:	equ	2h
; y_a_low address and mask equates
y_a_low_Data_ADDR:	equ	0h
y_a_low_DriveMode_0_ADDR:	equ	100h
y_a_low_DriveMode_1_ADDR:	equ	101h
y_a_low_DriveMode_2_ADDR:	equ	3h
y_a_low_GlobalSelect_ADDR:	equ	2h
y_a_low_IntCtrl_0_ADDR:	equ	102h
y_a_low_IntCtrl_1_ADDR:	equ	103h
y_a_low_IntEn_ADDR:	equ	1h
y_a_low_MASK:	equ	4h
; y_b_low address and mask equates
y_b_low_Data_ADDR:	equ	0h
y_b_low_DriveMode_0_ADDR:	equ	100h
y_b_low_DriveMode_1_ADDR:	equ	101h
y_b_low_DriveMode_2_ADDR:	equ	3h
y_b_low_GlobalSelect_ADDR:	equ	2h
y_b_low_IntCtrl_0_ADDR:	equ	102h
y_b_low_IntCtrl_1_ADDR:	equ	103h
y_b_low_IntEn_ADDR:	equ	1h
y_b_low_MASK:	equ	8h
; z_a_low address and mask equates
z_a_low_Data_ADDR:	equ	0h
z_a_low_DriveMode_0_ADDR:	equ	100h
z_a_low_DriveMode_1_ADDR:	equ	101h
z_a_low_DriveMode_2_ADDR:	equ	3h
z_a_low_GlobalSelect_ADDR:	equ	2h
z_a_low_IntCtrl_0_ADDR:	equ	102h
z_a_low_IntCtrl_1_ADDR:	equ	103h
z_a_low_IntEn_ADDR:	equ	1h
z_a_low_MASK:	equ	10h
; z_b_low address and mask equates
z_b_low_Data_ADDR:	equ	0h
z_b_low_DriveMode_0_ADDR:	equ	100h
z_b_low_DriveMode_1_ADDR:	equ	101h
z_b_low_DriveMode_2_ADDR:	equ	3h
z_b_low_GlobalSelect_ADDR:	equ	2h
z_b_low_IntCtrl_0_ADDR:	equ	102h
z_b_low_IntCtrl_1_ADDR:	equ	103h
z_b_low_IntEn_ADDR:	equ	1h
z_b_low_MASK:	equ	20h
; EzI2Cs_1SDA address and mask equates
EzI2Cs_1SDA_Data_ADDR:	equ	4h
EzI2Cs_1SDA_DriveMode_0_ADDR:	equ	104h
EzI2Cs_1SDA_DriveMode_1_ADDR:	equ	105h
EzI2Cs_1SDA_DriveMode_2_ADDR:	equ	7h
EzI2Cs_1SDA_GlobalSelect_ADDR:	equ	6h
EzI2Cs_1SDA_IntCtrl_0_ADDR:	equ	106h
EzI2Cs_1SDA_IntCtrl_1_ADDR:	equ	107h
EzI2Cs_1SDA_IntEn_ADDR:	equ	5h
EzI2Cs_1SDA_MASK:	equ	20h
; EzI2Cs_1SCL address and mask equates
EzI2Cs_1SCL_Data_ADDR:	equ	4h
EzI2Cs_1SCL_DriveMode_0_ADDR:	equ	104h
EzI2Cs_1SCL_DriveMode_1_ADDR:	equ	105h
EzI2Cs_1SCL_DriveMode_2_ADDR:	equ	7h
EzI2Cs_1SCL_GlobalSelect_ADDR:	equ	6h
EzI2Cs_1SCL_IntCtrl_0_ADDR:	equ	106h
EzI2Cs_1SCL_IntCtrl_1_ADDR:	equ	107h
EzI2Cs_1SCL_IntEn_ADDR:	equ	5h
EzI2Cs_1SCL_MASK:	equ	80h
; AGND address and mask equates
AGND_Data_ADDR:	equ	8h
AGND_DriveMode_0_ADDR:	equ	108h
AGND_DriveMode_1_ADDR:	equ	109h
AGND_DriveMode_2_ADDR:	equ	bh
AGND_GlobalSelect_ADDR:	equ	ah
AGND_IntCtrl_0_ADDR:	equ	10ah
AGND_IntCtrl_1_ADDR:	equ	10bh
AGND_IntEn_ADDR:	equ	9h
AGND_MASK:	equ	10h
