;;*****************************************************************************
;;*****************************************************************************
;;  FILENAME: PRS24_1.inc
;;   Version: 3.4, Updated on 2013/5/19 at 10:44:1
;;  Generated by PSoC Designer 5.4.2946
;;
;;  DESCRIPTION: Assembler declarations for the PRS24 user module interface.
;;-----------------------------------------------------------------------------
;;  Copyright (c) Cypress Semiconductor 2013. All Rights Reserved.
;;*****************************************************************************
;;*****************************************************************************

include "m8c.inc"

;--------------------------------------------------
; Constants for PRS24_1 API's.
;--------------------------------------------------

;--------------------------------------------------
; Register Address Constants for PRS24_1
;--------------------------------------------------
PRS24_1_CONTROL_REG_LSB:    equ 23h              ;Control register LSB
PRS24_1_CONTROL_REG_ISB:    equ 27h              ;Control register ISB
PRS24_1_CONTROL_REG_MSB:    equ 2bh              ;Control register MSB
PRS24_1_SHIFT_REG_LSB:  equ 20h                  ;Shift register LSB
PRS24_1_SHIFT_REG_ISB:  equ 24h                  ;Shift register ISB
PRS24_1_SHIFT_REG_MSB:  equ 28h                  ;Shift register MSB
PRS24_1_POLY_REG_LSB:   equ 21h                  ;Polynomial register LSB
PRS24_1_POLY_REG_ISB:   equ 25h                  ;Polynomial register ISB
PRS24_1_POLY_REG_MSB:   equ 29h                  ;Polynomial register MSB
PRS24_1_SEED_REG_LSB:   equ 22h                  ;Seed register LSB
PRS24_1_SEED_REG_ISB:   equ 26h                  ;Seed register ISB
PRS24_1_SEED_REG_MSB:   equ 2ah                  ;Seed register MSB
PRS24_1_FUNC_REG_LSB:   equ 20h                  ;Function register LSB
PRS24_1_FUNC_REG_ISB:   equ 24h                  ;Function register ISB
PRS24_1_FUNC_REG_MSB:   equ 28h                  ;Function register MSB
PRS24_1_INPUT_REG_LSB:  equ 21h                  ;Input register LSB
PRS24_1_INPUT_REG_ISB:  equ 25h                  ;Input register ISB
PRS24_1_INPUT_REG_MSB:  equ 29h                  ;Input register MSB
PRS24_1_OUTPUT_REG_LSB: equ 22h                  ;Output register LSB
PRS24_1_OUTPUT_REG_ISB: equ 26h                  ;Output register ISB
PRS24_1_OUTPUT_REG_MSB: equ 2ah                  ;Output register MSB

; end of file PRS24_1.inc
