;;*****************************************************************************
;;*****************************************************************************
;;  FILENAME: PRS24_2.inc
;;   Version: 3.4, Updated on 2013/5/19 at 10:44:1
;;  Generated by PSoC Designer 5.4.2946
;;
;;  DESCRIPTION: Assembler declarations for the PRS24 user module interface.
;;-----------------------------------------------------------------------------
;;  Copyright (c) Cypress Semiconductor 2013. All Rights Reserved.
;;*****************************************************************************
;;*****************************************************************************

include "m8c.inc"

;--------------------------------------------------
; Constants for PRS24_2 API's.
;--------------------------------------------------

;--------------------------------------------------
; Register Address Constants for PRS24_2
;--------------------------------------------------
PRS24_2_CONTROL_REG_LSB:    equ 33h              ;Control register LSB
PRS24_2_CONTROL_REG_ISB:    equ 37h              ;Control register ISB
PRS24_2_CONTROL_REG_MSB:    equ 3bh              ;Control register MSB
PRS24_2_SHIFT_REG_LSB:  equ 30h                  ;Shift register LSB
PRS24_2_SHIFT_REG_ISB:  equ 34h                  ;Shift register ISB
PRS24_2_SHIFT_REG_MSB:  equ 38h                  ;Shift register MSB
PRS24_2_POLY_REG_LSB:   equ 31h                  ;Polynomial register LSB
PRS24_2_POLY_REG_ISB:   equ 35h                  ;Polynomial register ISB
PRS24_2_POLY_REG_MSB:   equ 39h                  ;Polynomial register MSB
PRS24_2_SEED_REG_LSB:   equ 32h                  ;Seed register LSB
PRS24_2_SEED_REG_ISB:   equ 36h                  ;Seed register ISB
PRS24_2_SEED_REG_MSB:   equ 3ah                  ;Seed register MSB
PRS24_2_FUNC_REG_LSB:   equ 30h                  ;Function register LSB
PRS24_2_FUNC_REG_ISB:   equ 34h                  ;Function register ISB
PRS24_2_FUNC_REG_MSB:   equ 38h                  ;Function register MSB
PRS24_2_INPUT_REG_LSB:  equ 31h                  ;Input register LSB
PRS24_2_INPUT_REG_ISB:  equ 35h                  ;Input register ISB
PRS24_2_INPUT_REG_MSB:  equ 39h                  ;Input register MSB
PRS24_2_OUTPUT_REG_LSB: equ 32h                  ;Output register LSB
PRS24_2_OUTPUT_REG_ISB: equ 36h                  ;Output register ISB
PRS24_2_OUTPUT_REG_MSB: equ 3ah                  ;Output register MSB

; end of file PRS24_2.inc
