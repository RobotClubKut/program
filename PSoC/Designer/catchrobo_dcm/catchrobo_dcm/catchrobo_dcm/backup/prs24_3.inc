;;*****************************************************************************
;;*****************************************************************************
;;  FILENAME: PRS24_3.inc
;;   Version: 3.4, Updated on 2013/5/19 at 10:44:1
;;  Generated by PSoC Designer 5.4.2946
;;
;;  DESCRIPTION: Assembler declarations for the PRS24 user module interface.
;;-----------------------------------------------------------------------------
;;  Copyright (c) Cypress Semiconductor 2013. All Rights Reserved.
;;*****************************************************************************
;;*****************************************************************************

include "m8c.inc"

;--------------------------------------------------
; Constants for PRS24_3 API's.
;--------------------------------------------------

;--------------------------------------------------
; Register Address Constants for PRS24_3
;--------------------------------------------------
PRS24_3_CONTROL_REG_LSB:    equ 3fh              ;Control register LSB
PRS24_3_CONTROL_REG_ISB:    equ 43h              ;Control register ISB
PRS24_3_CONTROL_REG_MSB:    equ 47h              ;Control register MSB
PRS24_3_SHIFT_REG_LSB:  equ 3ch                  ;Shift register LSB
PRS24_3_SHIFT_REG_ISB:  equ 40h                  ;Shift register ISB
PRS24_3_SHIFT_REG_MSB:  equ 44h                  ;Shift register MSB
PRS24_3_POLY_REG_LSB:   equ 3dh                  ;Polynomial register LSB
PRS24_3_POLY_REG_ISB:   equ 41h                  ;Polynomial register ISB
PRS24_3_POLY_REG_MSB:   equ 45h                  ;Polynomial register MSB
PRS24_3_SEED_REG_LSB:   equ 3eh                  ;Seed register LSB
PRS24_3_SEED_REG_ISB:   equ 42h                  ;Seed register ISB
PRS24_3_SEED_REG_MSB:   equ 46h                  ;Seed register MSB
PRS24_3_FUNC_REG_LSB:   equ 3ch                  ;Function register LSB
PRS24_3_FUNC_REG_ISB:   equ 40h                  ;Function register ISB
PRS24_3_FUNC_REG_MSB:   equ 44h                  ;Function register MSB
PRS24_3_INPUT_REG_LSB:  equ 3dh                  ;Input register LSB
PRS24_3_INPUT_REG_ISB:  equ 41h                  ;Input register ISB
PRS24_3_INPUT_REG_MSB:  equ 45h                  ;Input register MSB
PRS24_3_OUTPUT_REG_LSB: equ 3eh                  ;Output register LSB
PRS24_3_OUTPUT_REG_ISB: equ 42h                  ;Output register ISB
PRS24_3_OUTPUT_REG_MSB: equ 46h                  ;Output register MSB

; end of file PRS24_3.inc
