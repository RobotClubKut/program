;;*****************************************************************************
;;*****************************************************************************
;;  FILENAME: PRS32_1.inc
;;   Version: 3.4, Updated on 2013/5/19 at 10:44:2
;;  Generated by PSoC Designer 5.4.2946
;;
;;  DESCRIPTION: Assembler declarations for the PRS32 user module interface.
;;-----------------------------------------------------------------------------
;;  Copyright (c) Cypress Semiconductor 2013. All Rights Reserved.
;;*****************************************************************************
;;*****************************************************************************

include "m8c.inc"

;--------------------------------------------------
; Register Address Constants for PRS32_1
;--------------------------------------------------
PRS32_1_CONTROL_REG_LSB:    equ 33h              ;Control register LSB
PRS32_1_CONTROL_REG_ISB1:   equ 37h              ;Control register ISB1
PRS32_1_CONTROL_REG_ISB2:   equ 3bh              ;Control register ISB2
PRS32_1_CONTROL_REG_MSB:    equ 3fh              ;Control register MSB
PRS32_1_SHIFT_REG_LSB:  equ 30h                  ;Shift register LSB
PRS32_1_SHIFT_REG_ISB1: equ 34h                  ;Shift register ISB1
PRS32_1_SHIFT_REG_ISB2: equ 38h                  ;Shift register ISB2
PRS32_1_SHIFT_REG_MSB:  equ 3ch                  ;Shift register MSB
PRS32_1_POLY_REG_LSB:   equ 31h                  ;Polynomial register LSB
PRS32_1_POLY_REG_ISB1:  equ 35h                  ;Polynomial register ISB1
PRS32_1_POLY_REG_ISB2:  equ 39h                  ;Polynomial register ISB2
PRS32_1_POLY_REG_MSB:   equ 3dh                  ;Polynomial register MSB
PRS32_1_SEED_REG_LSB:   equ 32h                  ;Seed register LSB
PRS32_1_SEED_REG_ISB1:  equ 36h                  ;Seed register ISB1
PRS32_1_SEED_REG_ISB2:  equ 3ah                  ;Seed register ISB2
PRS32_1_SEED_REG_MSB:   equ 3eh                  ;Seed register MSB
PRS32_1_FUNC_REG_LSB:   equ 30h                  ;Function register LSB
PRS32_1_FUNC_REG_ISB1:  equ 34h                  ;Function register ISB1
PRS32_1_FUNC_REG_ISB2:  equ 38h                  ;Function register ISB2
PRS32_1_FUNC_REG_MSB:   equ 3ch                  ;Function register MSB
PRS32_1_INPUT_REG_LSB:  equ 31h                  ;Input register LSB
PRS32_1_INPUT_REG_ISB1: equ 35h                  ;Input register ISB1
PRS32_1_INPUT_REG_ISB2: equ 39h                  ;Input register ISB2
PRS32_1_INPUT_REG_MSB:  equ 3dh                  ;Input register MSB
PRS32_1_OUTPUT_REG_LSB: equ 32h                  ;Output register LSB
PRS32_1_OUTPUT_REG_ISB1:    equ 36h              ;Output register ISB1
PRS32_1_OUTPUT_REG_ISB2:    equ 3ah              ;Output register ISB2
PRS32_1_OUTPUT_REG_MSB: equ 3eh                  ;Output register MSB

; end of file PRS32_1.inc
