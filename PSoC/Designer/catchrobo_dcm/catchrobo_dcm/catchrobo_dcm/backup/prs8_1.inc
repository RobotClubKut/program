;;*****************************************************************************
;;*****************************************************************************
;;  FILENAME: PRS8_1.inc
;;   Version: 3.4, Updated on 2013/5/19 at 10:44:3
;;  Generated by PSoC Designer 5.4.2946
;;
;;  DESCRIPTION: Assembler declarations for the PRS8 user module interface.
;;-----------------------------------------------------------------------------
;;  Copyright (c) Cypress Semiconductor 2013. All Rights Reserved.
;;*****************************************************************************
;;*****************************************************************************

include "m8c.inc"

;--------------------------------------------------
; Constants for PRS8_1 API's.
;--------------------------------------------------

;--------------------------------------------------
; Register Address Constants for PRS8_1
;--------------------------------------------------
PRS8_1_CONTROL_REG: equ 23h                      ;Control register LSB
PRS8_1_SHIFT_REG:   equ 20h                      ;Shift register LSB
PRS8_1_POLY_REG:    equ 21h                      ;Polynomial register LSB
PRS8_1_SEED_REG:    equ 22h                      ;Seed register LSB
PRS8_1_FUNC_REG:    equ 20h                      ;Function register LSB
PRS8_1_INPUT_REG:   equ 21h                      ;Input register LSB
PRS8_1_OUTPUT_REG:  equ 22h                      ;Output register LSB

; end of file PRS8_1.inc
