;;*****************************************************************************
;;*****************************************************************************
;;  FILENAME: PRS8_3.inc
;;   Version: 3.4, Updated on 2013/5/19 at 10:44:3
;;  Generated by PSoC Designer 5.4.2946
;;
;;  DESCRIPTION: Assembler declarations for the PRS8 user module interface.
;;-----------------------------------------------------------------------------
;;  Copyright (c) Cypress Semiconductor 2013. All Rights Reserved.
;;*****************************************************************************
;;*****************************************************************************

include "m8c.inc"

;--------------------------------------------------
; Constants for PRS8_3 API's.
;--------------------------------------------------

;--------------------------------------------------
; Register Address Constants for PRS8_3
;--------------------------------------------------
PRS8_3_CONTROL_REG: equ 2bh                      ;Control register LSB
PRS8_3_SHIFT_REG:   equ 28h                      ;Shift register LSB
PRS8_3_POLY_REG:    equ 29h                      ;Polynomial register LSB
PRS8_3_SEED_REG:    equ 2ah                      ;Seed register LSB
PRS8_3_FUNC_REG:    equ 28h                      ;Function register LSB
PRS8_3_INPUT_REG:   equ 29h                      ;Input register LSB
PRS8_3_OUTPUT_REG:  equ 2ah                      ;Output register LSB

; end of file PRS8_3.inc
