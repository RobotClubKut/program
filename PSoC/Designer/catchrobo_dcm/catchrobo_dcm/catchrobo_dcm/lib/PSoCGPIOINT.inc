;  Generated by PSoC Designer 5.4.2946
;
; LCD_1D4 address and mask equates
LCD_1D4_Data_ADDR:	equ	0h
LCD_1D4_DriveMode_0_ADDR:	equ	100h
LCD_1D4_DriveMode_1_ADDR:	equ	101h
LCD_1D4_DriveMode_2_ADDR:	equ	3h
LCD_1D4_GlobalSelect_ADDR:	equ	2h
LCD_1D4_IntCtrl_0_ADDR:	equ	102h
LCD_1D4_IntCtrl_1_ADDR:	equ	103h
LCD_1D4_IntEn_ADDR:	equ	1h
LCD_1D4_MASK:	equ	1h
; LCD_1D4_Data access macros
;   GetLCD_1D4_Data macro, return in a
macro GetLCD_1D4_Data
	mov		a,[Port_0_Data_SHADE]
	and		a, 1h
endm
;   SetLCD_1D4_Data macro
macro SetLCD_1D4_Data
	or		[Port_0_Data_SHADE], 1h
	mov		a, [Port_0_Data_SHADE]
	mov		reg[LCD_1D4_Data_ADDR], a
endm
;   ClearLCD_1D4_Data macro
macro ClearLCD_1D4_Data
	and		[Port_0_Data_SHADE], ~1h
	mov		a, [Port_0_Data_SHADE]
	mov		reg[LCD_1D4_Data_ADDR], a
endm

; LCD_1D4_DriveMode_0 access macros
;   GetLCD_1D4_DriveMode_0 macro, return in a
macro GetLCD_1D4_DriveMode_0
	mov		a,[Port_0_DriveMode_0_SHADE]
	and		a, 1h
endm
;   SetLCD_1D4_DriveMode_0 macro
macro SetLCD_1D4_DriveMode_0
	or		[Port_0_DriveMode_0_SHADE], 1h
	mov		a, [Port_0_DriveMode_0_SHADE]
	mov		reg[LCD_1D4_Data_ADDR], a
endm
;   ClearLCD_1D4_DriveMode_0 macro
macro ClearLCD_1D4_DriveMode_0
	and		[Port_0_DriveMode_0_SHADE], ~1h
	mov		a, [Port_0_DriveMode_0_SHADE]
	mov		reg[LCD_1D4_Data_ADDR], a
endm

; LCD_1D4_DriveMode_1 access macros
;   GetLCD_1D4_DriveMode_1 macro, return in a
macro GetLCD_1D4_DriveMode_1
	mov		a,[Port_0_DriveMode_1_SHADE]
	and		a, 1h
endm
;   SetLCD_1D4_DriveMode_1 macro
macro SetLCD_1D4_DriveMode_1
	or		[Port_0_DriveMode_1_SHADE], 1h
	mov		a, [Port_0_DriveMode_1_SHADE]
	mov		reg[LCD_1D4_Data_ADDR], a
endm
;   ClearLCD_1D4_DriveMode_1 macro
macro ClearLCD_1D4_DriveMode_1
	and		[Port_0_DriveMode_1_SHADE], ~1h
	mov		a, [Port_0_DriveMode_1_SHADE]
	mov		reg[LCD_1D4_Data_ADDR], a
endm

; LCD_1D5 address and mask equates
LCD_1D5_Data_ADDR:	equ	0h
LCD_1D5_DriveMode_0_ADDR:	equ	100h
LCD_1D5_DriveMode_1_ADDR:	equ	101h
LCD_1D5_DriveMode_2_ADDR:	equ	3h
LCD_1D5_GlobalSelect_ADDR:	equ	2h
LCD_1D5_IntCtrl_0_ADDR:	equ	102h
LCD_1D5_IntCtrl_1_ADDR:	equ	103h
LCD_1D5_IntEn_ADDR:	equ	1h
LCD_1D5_MASK:	equ	2h
; LCD_1D5_Data access macros
;   GetLCD_1D5_Data macro, return in a
macro GetLCD_1D5_Data
	mov		a,[Port_0_Data_SHADE]
	and		a, 2h
endm
;   SetLCD_1D5_Data macro
macro SetLCD_1D5_Data
	or		[Port_0_Data_SHADE], 2h
	mov		a, [Port_0_Data_SHADE]
	mov		reg[LCD_1D5_Data_ADDR], a
endm
;   ClearLCD_1D5_Data macro
macro ClearLCD_1D5_Data
	and		[Port_0_Data_SHADE], ~2h
	mov		a, [Port_0_Data_SHADE]
	mov		reg[LCD_1D5_Data_ADDR], a
endm

; LCD_1D5_DriveMode_0 access macros
;   GetLCD_1D5_DriveMode_0 macro, return in a
macro GetLCD_1D5_DriveMode_0
	mov		a,[Port_0_DriveMode_0_SHADE]
	and		a, 2h
endm
;   SetLCD_1D5_DriveMode_0 macro
macro SetLCD_1D5_DriveMode_0
	or		[Port_0_DriveMode_0_SHADE], 2h
	mov		a, [Port_0_DriveMode_0_SHADE]
	mov		reg[LCD_1D5_Data_ADDR], a
endm
;   ClearLCD_1D5_DriveMode_0 macro
macro ClearLCD_1D5_DriveMode_0
	and		[Port_0_DriveMode_0_SHADE], ~2h
	mov		a, [Port_0_DriveMode_0_SHADE]
	mov		reg[LCD_1D5_Data_ADDR], a
endm

; LCD_1D5_DriveMode_1 access macros
;   GetLCD_1D5_DriveMode_1 macro, return in a
macro GetLCD_1D5_DriveMode_1
	mov		a,[Port_0_DriveMode_1_SHADE]
	and		a, 2h
endm
;   SetLCD_1D5_DriveMode_1 macro
macro SetLCD_1D5_DriveMode_1
	or		[Port_0_DriveMode_1_SHADE], 2h
	mov		a, [Port_0_DriveMode_1_SHADE]
	mov		reg[LCD_1D5_Data_ADDR], a
endm
;   ClearLCD_1D5_DriveMode_1 macro
macro ClearLCD_1D5_DriveMode_1
	and		[Port_0_DriveMode_1_SHADE], ~2h
	mov		a, [Port_0_DriveMode_1_SHADE]
	mov		reg[LCD_1D5_Data_ADDR], a
endm

; LCD_1D6 address and mask equates
LCD_1D6_Data_ADDR:	equ	0h
LCD_1D6_DriveMode_0_ADDR:	equ	100h
LCD_1D6_DriveMode_1_ADDR:	equ	101h
LCD_1D6_DriveMode_2_ADDR:	equ	3h
LCD_1D6_GlobalSelect_ADDR:	equ	2h
LCD_1D6_IntCtrl_0_ADDR:	equ	102h
LCD_1D6_IntCtrl_1_ADDR:	equ	103h
LCD_1D6_IntEn_ADDR:	equ	1h
LCD_1D6_MASK:	equ	4h
; LCD_1D6_Data access macros
;   GetLCD_1D6_Data macro, return in a
macro GetLCD_1D6_Data
	mov		a,[Port_0_Data_SHADE]
	and		a, 4h
endm
;   SetLCD_1D6_Data macro
macro SetLCD_1D6_Data
	or		[Port_0_Data_SHADE], 4h
	mov		a, [Port_0_Data_SHADE]
	mov		reg[LCD_1D6_Data_ADDR], a
endm
;   ClearLCD_1D6_Data macro
macro ClearLCD_1D6_Data
	and		[Port_0_Data_SHADE], ~4h
	mov		a, [Port_0_Data_SHADE]
	mov		reg[LCD_1D6_Data_ADDR], a
endm

; LCD_1D6_DriveMode_0 access macros
;   GetLCD_1D6_DriveMode_0 macro, return in a
macro GetLCD_1D6_DriveMode_0
	mov		a,[Port_0_DriveMode_0_SHADE]
	and		a, 4h
endm
;   SetLCD_1D6_DriveMode_0 macro
macro SetLCD_1D6_DriveMode_0
	or		[Port_0_DriveMode_0_SHADE], 4h
	mov		a, [Port_0_DriveMode_0_SHADE]
	mov		reg[LCD_1D6_Data_ADDR], a
endm
;   ClearLCD_1D6_DriveMode_0 macro
macro ClearLCD_1D6_DriveMode_0
	and		[Port_0_DriveMode_0_SHADE], ~4h
	mov		a, [Port_0_DriveMode_0_SHADE]
	mov		reg[LCD_1D6_Data_ADDR], a
endm

; LCD_1D6_DriveMode_1 access macros
;   GetLCD_1D6_DriveMode_1 macro, return in a
macro GetLCD_1D6_DriveMode_1
	mov		a,[Port_0_DriveMode_1_SHADE]
	and		a, 4h
endm
;   SetLCD_1D6_DriveMode_1 macro
macro SetLCD_1D6_DriveMode_1
	or		[Port_0_DriveMode_1_SHADE], 4h
	mov		a, [Port_0_DriveMode_1_SHADE]
	mov		reg[LCD_1D6_Data_ADDR], a
endm
;   ClearLCD_1D6_DriveMode_1 macro
macro ClearLCD_1D6_DriveMode_1
	and		[Port_0_DriveMode_1_SHADE], ~4h
	mov		a, [Port_0_DriveMode_1_SHADE]
	mov		reg[LCD_1D6_Data_ADDR], a
endm

; LCD_1D7 address and mask equates
LCD_1D7_Data_ADDR:	equ	0h
LCD_1D7_DriveMode_0_ADDR:	equ	100h
LCD_1D7_DriveMode_1_ADDR:	equ	101h
LCD_1D7_DriveMode_2_ADDR:	equ	3h
LCD_1D7_GlobalSelect_ADDR:	equ	2h
LCD_1D7_IntCtrl_0_ADDR:	equ	102h
LCD_1D7_IntCtrl_1_ADDR:	equ	103h
LCD_1D7_IntEn_ADDR:	equ	1h
LCD_1D7_MASK:	equ	8h
; LCD_1D7_Data access macros
;   GetLCD_1D7_Data macro, return in a
macro GetLCD_1D7_Data
	mov		a,[Port_0_Data_SHADE]
	and		a, 8h
endm
;   SetLCD_1D7_Data macro
macro SetLCD_1D7_Data
	or		[Port_0_Data_SHADE], 8h
	mov		a, [Port_0_Data_SHADE]
	mov		reg[LCD_1D7_Data_ADDR], a
endm
;   ClearLCD_1D7_Data macro
macro ClearLCD_1D7_Data
	and		[Port_0_Data_SHADE], ~8h
	mov		a, [Port_0_Data_SHADE]
	mov		reg[LCD_1D7_Data_ADDR], a
endm

; LCD_1D7_DriveMode_0 access macros
;   GetLCD_1D7_DriveMode_0 macro, return in a
macro GetLCD_1D7_DriveMode_0
	mov		a,[Port_0_DriveMode_0_SHADE]
	and		a, 8h
endm
;   SetLCD_1D7_DriveMode_0 macro
macro SetLCD_1D7_DriveMode_0
	or		[Port_0_DriveMode_0_SHADE], 8h
	mov		a, [Port_0_DriveMode_0_SHADE]
	mov		reg[LCD_1D7_Data_ADDR], a
endm
;   ClearLCD_1D7_DriveMode_0 macro
macro ClearLCD_1D7_DriveMode_0
	and		[Port_0_DriveMode_0_SHADE], ~8h
	mov		a, [Port_0_DriveMode_0_SHADE]
	mov		reg[LCD_1D7_Data_ADDR], a
endm

; LCD_1D7_DriveMode_1 access macros
;   GetLCD_1D7_DriveMode_1 macro, return in a
macro GetLCD_1D7_DriveMode_1
	mov		a,[Port_0_DriveMode_1_SHADE]
	and		a, 8h
endm
;   SetLCD_1D7_DriveMode_1 macro
macro SetLCD_1D7_DriveMode_1
	or		[Port_0_DriveMode_1_SHADE], 8h
	mov		a, [Port_0_DriveMode_1_SHADE]
	mov		reg[LCD_1D7_Data_ADDR], a
endm
;   ClearLCD_1D7_DriveMode_1 macro
macro ClearLCD_1D7_DriveMode_1
	and		[Port_0_DriveMode_1_SHADE], ~8h
	mov		a, [Port_0_DriveMode_1_SHADE]
	mov		reg[LCD_1D7_Data_ADDR], a
endm

; LCD_1E address and mask equates
LCD_1E_Data_ADDR:	equ	0h
LCD_1E_DriveMode_0_ADDR:	equ	100h
LCD_1E_DriveMode_1_ADDR:	equ	101h
LCD_1E_DriveMode_2_ADDR:	equ	3h
LCD_1E_GlobalSelect_ADDR:	equ	2h
LCD_1E_IntCtrl_0_ADDR:	equ	102h
LCD_1E_IntCtrl_1_ADDR:	equ	103h
LCD_1E_IntEn_ADDR:	equ	1h
LCD_1E_MASK:	equ	10h
; LCD_1E_Data access macros
;   GetLCD_1E_Data macro, return in a
macro GetLCD_1E_Data
	mov		a,[Port_0_Data_SHADE]
	and		a, 10h
endm
;   SetLCD_1E_Data macro
macro SetLCD_1E_Data
	or		[Port_0_Data_SHADE], 10h
	mov		a, [Port_0_Data_SHADE]
	mov		reg[LCD_1E_Data_ADDR], a
endm
;   ClearLCD_1E_Data macro
macro ClearLCD_1E_Data
	and		[Port_0_Data_SHADE], ~10h
	mov		a, [Port_0_Data_SHADE]
	mov		reg[LCD_1E_Data_ADDR], a
endm

; LCD_1E_DriveMode_0 access macros
;   GetLCD_1E_DriveMode_0 macro, return in a
macro GetLCD_1E_DriveMode_0
	mov		a,[Port_0_DriveMode_0_SHADE]
	and		a, 10h
endm
;   SetLCD_1E_DriveMode_0 macro
macro SetLCD_1E_DriveMode_0
	or		[Port_0_DriveMode_0_SHADE], 10h
	mov		a, [Port_0_DriveMode_0_SHADE]
	mov		reg[LCD_1E_Data_ADDR], a
endm
;   ClearLCD_1E_DriveMode_0 macro
macro ClearLCD_1E_DriveMode_0
	and		[Port_0_DriveMode_0_SHADE], ~10h
	mov		a, [Port_0_DriveMode_0_SHADE]
	mov		reg[LCD_1E_Data_ADDR], a
endm

; LCD_1E_DriveMode_1 access macros
;   GetLCD_1E_DriveMode_1 macro, return in a
macro GetLCD_1E_DriveMode_1
	mov		a,[Port_0_DriveMode_1_SHADE]
	and		a, 10h
endm
;   SetLCD_1E_DriveMode_1 macro
macro SetLCD_1E_DriveMode_1
	or		[Port_0_DriveMode_1_SHADE], 10h
	mov		a, [Port_0_DriveMode_1_SHADE]
	mov		reg[LCD_1E_Data_ADDR], a
endm
;   ClearLCD_1E_DriveMode_1 macro
macro ClearLCD_1E_DriveMode_1
	and		[Port_0_DriveMode_1_SHADE], ~10h
	mov		a, [Port_0_DriveMode_1_SHADE]
	mov		reg[LCD_1E_Data_ADDR], a
endm

; LCD_1RS address and mask equates
LCD_1RS_Data_ADDR:	equ	0h
LCD_1RS_DriveMode_0_ADDR:	equ	100h
LCD_1RS_DriveMode_1_ADDR:	equ	101h
LCD_1RS_DriveMode_2_ADDR:	equ	3h
LCD_1RS_GlobalSelect_ADDR:	equ	2h
LCD_1RS_IntCtrl_0_ADDR:	equ	102h
LCD_1RS_IntCtrl_1_ADDR:	equ	103h
LCD_1RS_IntEn_ADDR:	equ	1h
LCD_1RS_MASK:	equ	20h
; LCD_1RS_Data access macros
;   GetLCD_1RS_Data macro, return in a
macro GetLCD_1RS_Data
	mov		a,[Port_0_Data_SHADE]
	and		a, 20h
endm
;   SetLCD_1RS_Data macro
macro SetLCD_1RS_Data
	or		[Port_0_Data_SHADE], 20h
	mov		a, [Port_0_Data_SHADE]
	mov		reg[LCD_1RS_Data_ADDR], a
endm
;   ClearLCD_1RS_Data macro
macro ClearLCD_1RS_Data
	and		[Port_0_Data_SHADE], ~20h
	mov		a, [Port_0_Data_SHADE]
	mov		reg[LCD_1RS_Data_ADDR], a
endm

; LCD_1RS_DriveMode_0 access macros
;   GetLCD_1RS_DriveMode_0 macro, return in a
macro GetLCD_1RS_DriveMode_0
	mov		a,[Port_0_DriveMode_0_SHADE]
	and		a, 20h
endm
;   SetLCD_1RS_DriveMode_0 macro
macro SetLCD_1RS_DriveMode_0
	or		[Port_0_DriveMode_0_SHADE], 20h
	mov		a, [Port_0_DriveMode_0_SHADE]
	mov		reg[LCD_1RS_Data_ADDR], a
endm
;   ClearLCD_1RS_DriveMode_0 macro
macro ClearLCD_1RS_DriveMode_0
	and		[Port_0_DriveMode_0_SHADE], ~20h
	mov		a, [Port_0_DriveMode_0_SHADE]
	mov		reg[LCD_1RS_Data_ADDR], a
endm

; LCD_1RS_DriveMode_1 access macros
;   GetLCD_1RS_DriveMode_1 macro, return in a
macro GetLCD_1RS_DriveMode_1
	mov		a,[Port_0_DriveMode_1_SHADE]
	and		a, 20h
endm
;   SetLCD_1RS_DriveMode_1 macro
macro SetLCD_1RS_DriveMode_1
	or		[Port_0_DriveMode_1_SHADE], 20h
	mov		a, [Port_0_DriveMode_1_SHADE]
	mov		reg[LCD_1RS_Data_ADDR], a
endm
;   ClearLCD_1RS_DriveMode_1 macro
macro ClearLCD_1RS_DriveMode_1
	and		[Port_0_DriveMode_1_SHADE], ~20h
	mov		a, [Port_0_DriveMode_1_SHADE]
	mov		reg[LCD_1RS_Data_ADDR], a
endm

; LCD_1RW address and mask equates
LCD_1RW_Data_ADDR:	equ	0h
LCD_1RW_DriveMode_0_ADDR:	equ	100h
LCD_1RW_DriveMode_1_ADDR:	equ	101h
LCD_1RW_DriveMode_2_ADDR:	equ	3h
LCD_1RW_GlobalSelect_ADDR:	equ	2h
LCD_1RW_IntCtrl_0_ADDR:	equ	102h
LCD_1RW_IntCtrl_1_ADDR:	equ	103h
LCD_1RW_IntEn_ADDR:	equ	1h
LCD_1RW_MASK:	equ	40h
; LCD_1RW_Data access macros
;   GetLCD_1RW_Data macro, return in a
macro GetLCD_1RW_Data
	mov		a,[Port_0_Data_SHADE]
	and		a, 40h
endm
;   SetLCD_1RW_Data macro
macro SetLCD_1RW_Data
	or		[Port_0_Data_SHADE], 40h
	mov		a, [Port_0_Data_SHADE]
	mov		reg[LCD_1RW_Data_ADDR], a
endm
;   ClearLCD_1RW_Data macro
macro ClearLCD_1RW_Data
	and		[Port_0_Data_SHADE], ~40h
	mov		a, [Port_0_Data_SHADE]
	mov		reg[LCD_1RW_Data_ADDR], a
endm

; LCD_1RW_DriveMode_0 access macros
;   GetLCD_1RW_DriveMode_0 macro, return in a
macro GetLCD_1RW_DriveMode_0
	mov		a,[Port_0_DriveMode_0_SHADE]
	and		a, 40h
endm
;   SetLCD_1RW_DriveMode_0 macro
macro SetLCD_1RW_DriveMode_0
	or		[Port_0_DriveMode_0_SHADE], 40h
	mov		a, [Port_0_DriveMode_0_SHADE]
	mov		reg[LCD_1RW_Data_ADDR], a
endm
;   ClearLCD_1RW_DriveMode_0 macro
macro ClearLCD_1RW_DriveMode_0
	and		[Port_0_DriveMode_0_SHADE], ~40h
	mov		a, [Port_0_DriveMode_0_SHADE]
	mov		reg[LCD_1RW_Data_ADDR], a
endm

; LCD_1RW_DriveMode_1 access macros
;   GetLCD_1RW_DriveMode_1 macro, return in a
macro GetLCD_1RW_DriveMode_1
	mov		a,[Port_0_DriveMode_1_SHADE]
	and		a, 40h
endm
;   SetLCD_1RW_DriveMode_1 macro
macro SetLCD_1RW_DriveMode_1
	or		[Port_0_DriveMode_1_SHADE], 40h
	mov		a, [Port_0_DriveMode_1_SHADE]
	mov		reg[LCD_1RW_Data_ADDR], a
endm
;   ClearLCD_1RW_DriveMode_1 macro
macro ClearLCD_1RW_DriveMode_1
	and		[Port_0_DriveMode_1_SHADE], ~40h
	mov		a, [Port_0_DriveMode_1_SHADE]
	mov		reg[LCD_1RW_Data_ADDR], a
endm

; ZBL address and mask equates
ZBL_Data_ADDR:	equ	0h
ZBL_DriveMode_0_ADDR:	equ	100h
ZBL_DriveMode_1_ADDR:	equ	101h
ZBL_DriveMode_2_ADDR:	equ	3h
ZBL_GlobalSelect_ADDR:	equ	2h
ZBL_IntCtrl_0_ADDR:	equ	102h
ZBL_IntCtrl_1_ADDR:	equ	103h
ZBL_IntEn_ADDR:	equ	1h
ZBL_MASK:	equ	80h
; ZBL_Data access macros
;   GetZBL_Data macro, return in a
macro GetZBL_Data
	mov		a,[Port_0_Data_SHADE]
	and		a, 80h
endm
;   SetZBL_Data macro
macro SetZBL_Data
	or		[Port_0_Data_SHADE], 80h
	mov		a, [Port_0_Data_SHADE]
	mov		reg[ZBL_Data_ADDR], a
endm
;   ClearZBL_Data macro
macro ClearZBL_Data
	and		[Port_0_Data_SHADE], ~80h
	mov		a, [Port_0_Data_SHADE]
	mov		reg[ZBL_Data_ADDR], a
endm

; ZBL_DriveMode_0 access macros
;   GetZBL_DriveMode_0 macro, return in a
macro GetZBL_DriveMode_0
	mov		a,[Port_0_DriveMode_0_SHADE]
	and		a, 80h
endm
;   SetZBL_DriveMode_0 macro
macro SetZBL_DriveMode_0
	or		[Port_0_DriveMode_0_SHADE], 80h
	mov		a, [Port_0_DriveMode_0_SHADE]
	mov		reg[ZBL_Data_ADDR], a
endm
;   ClearZBL_DriveMode_0 macro
macro ClearZBL_DriveMode_0
	and		[Port_0_DriveMode_0_SHADE], ~80h
	mov		a, [Port_0_DriveMode_0_SHADE]
	mov		reg[ZBL_Data_ADDR], a
endm

; ZBL_DriveMode_1 access macros
;   GetZBL_DriveMode_1 macro, return in a
macro GetZBL_DriveMode_1
	mov		a,[Port_0_DriveMode_1_SHADE]
	and		a, 80h
endm
;   SetZBL_DriveMode_1 macro
macro SetZBL_DriveMode_1
	or		[Port_0_DriveMode_1_SHADE], 80h
	mov		a, [Port_0_DriveMode_1_SHADE]
	mov		reg[ZBL_Data_ADDR], a
endm
;   ClearZBL_DriveMode_1 macro
macro ClearZBL_DriveMode_1
	and		[Port_0_DriveMode_1_SHADE], ~80h
	mov		a, [Port_0_DriveMode_1_SHADE]
	mov		reg[ZBL_Data_ADDR], a
endm

; XTAL_Out address and mask equates
XTAL_Out_Data_ADDR:	equ	4h
XTAL_Out_DriveMode_0_ADDR:	equ	104h
XTAL_Out_DriveMode_1_ADDR:	equ	105h
XTAL_Out_DriveMode_2_ADDR:	equ	7h
XTAL_Out_GlobalSelect_ADDR:	equ	6h
XTAL_Out_IntCtrl_0_ADDR:	equ	106h
XTAL_Out_IntCtrl_1_ADDR:	equ	107h
XTAL_Out_IntEn_ADDR:	equ	5h
XTAL_Out_MASK:	equ	1h
; XTAL_Out_Data access macros
;   GetXTAL_Out_Data macro, return in a
macro GetXTAL_Out_Data
	mov		a,[Port_1_Data_SHADE]
	and		a, 1h
endm
;   SetXTAL_Out_Data macro
macro SetXTAL_Out_Data
	or		[Port_1_Data_SHADE], 1h
	mov		a, [Port_1_Data_SHADE]
	mov		reg[XTAL_Out_Data_ADDR], a
endm
;   ClearXTAL_Out_Data macro
macro ClearXTAL_Out_Data
	and		[Port_1_Data_SHADE], ~1h
	mov		a, [Port_1_Data_SHADE]
	mov		reg[XTAL_Out_Data_ADDR], a
endm

; XTAL_In address and mask equates
XTAL_In_Data_ADDR:	equ	4h
XTAL_In_DriveMode_0_ADDR:	equ	104h
XTAL_In_DriveMode_1_ADDR:	equ	105h
XTAL_In_DriveMode_2_ADDR:	equ	7h
XTAL_In_GlobalSelect_ADDR:	equ	6h
XTAL_In_IntCtrl_0_ADDR:	equ	106h
XTAL_In_IntCtrl_1_ADDR:	equ	107h
XTAL_In_IntEn_ADDR:	equ	5h
XTAL_In_MASK:	equ	2h
; XTAL_In_Data access macros
;   GetXTAL_In_Data macro, return in a
macro GetXTAL_In_Data
	mov		a,[Port_1_Data_SHADE]
	and		a, 2h
endm
;   SetXTAL_In_Data macro
macro SetXTAL_In_Data
	or		[Port_1_Data_SHADE], 2h
	mov		a, [Port_1_Data_SHADE]
	mov		reg[XTAL_In_Data_ADDR], a
endm
;   ClearXTAL_In_Data macro
macro ClearXTAL_In_Data
	and		[Port_1_Data_SHADE], ~2h
	mov		a, [Port_1_Data_SHADE]
	mov		reg[XTAL_In_Data_ADDR], a
endm

; XAL address and mask equates
XAL_Data_ADDR:	equ	4h
XAL_DriveMode_0_ADDR:	equ	104h
XAL_DriveMode_1_ADDR:	equ	105h
XAL_DriveMode_2_ADDR:	equ	7h
XAL_GlobalSelect_ADDR:	equ	6h
XAL_IntCtrl_0_ADDR:	equ	106h
XAL_IntCtrl_1_ADDR:	equ	107h
XAL_IntEn_ADDR:	equ	5h
XAL_MASK:	equ	4h
; XAL_Data access macros
;   GetXAL_Data macro, return in a
macro GetXAL_Data
	mov		a,[Port_1_Data_SHADE]
	and		a, 4h
endm
;   SetXAL_Data macro
macro SetXAL_Data
	or		[Port_1_Data_SHADE], 4h
	mov		a, [Port_1_Data_SHADE]
	mov		reg[XAL_Data_ADDR], a
endm
;   ClearXAL_Data macro
macro ClearXAL_Data
	and		[Port_1_Data_SHADE], ~4h
	mov		a, [Port_1_Data_SHADE]
	mov		reg[XAL_Data_ADDR], a
endm

; XAH address and mask equates
XAH_Data_ADDR:	equ	4h
XAH_DriveMode_0_ADDR:	equ	104h
XAH_DriveMode_1_ADDR:	equ	105h
XAH_DriveMode_2_ADDR:	equ	7h
XAH_GlobalSelect_ADDR:	equ	6h
XAH_IntCtrl_0_ADDR:	equ	106h
XAH_IntCtrl_1_ADDR:	equ	107h
XAH_IntEn_ADDR:	equ	5h
XAH_MASK:	equ	8h
; XAH_Data access macros
;   GetXAH_Data macro, return in a
macro GetXAH_Data
	mov		a,[Port_1_Data_SHADE]
	and		a, 8h
endm
;   SetXAH_Data macro
macro SetXAH_Data
	or		[Port_1_Data_SHADE], 8h
	mov		a, [Port_1_Data_SHADE]
	mov		reg[XAH_Data_ADDR], a
endm
;   ClearXAH_Data macro
macro ClearXAH_Data
	and		[Port_1_Data_SHADE], ~8h
	mov		a, [Port_1_Data_SHADE]
	mov		reg[XAH_Data_ADDR], a
endm

; XBH address and mask equates
XBH_Data_ADDR:	equ	4h
XBH_DriveMode_0_ADDR:	equ	104h
XBH_DriveMode_1_ADDR:	equ	105h
XBH_DriveMode_2_ADDR:	equ	7h
XBH_GlobalSelect_ADDR:	equ	6h
XBH_IntCtrl_0_ADDR:	equ	106h
XBH_IntCtrl_1_ADDR:	equ	107h
XBH_IntEn_ADDR:	equ	5h
XBH_MASK:	equ	10h
; XBH_Data access macros
;   GetXBH_Data macro, return in a
macro GetXBH_Data
	mov		a,[Port_1_Data_SHADE]
	and		a, 10h
endm
;   SetXBH_Data macro
macro SetXBH_Data
	or		[Port_1_Data_SHADE], 10h
	mov		a, [Port_1_Data_SHADE]
	mov		reg[XBH_Data_ADDR], a
endm
;   ClearXBH_Data macro
macro ClearXBH_Data
	and		[Port_1_Data_SHADE], ~10h
	mov		a, [Port_1_Data_SHADE]
	mov		reg[XBH_Data_ADDR], a
endm

; EzI2Cs_1SDA address and mask equates
EzI2Cs_1SDA_Data_ADDR:	equ	4h
EzI2Cs_1SDA_DriveMode_0_ADDR:	equ	104h
EzI2Cs_1SDA_DriveMode_1_ADDR:	equ	105h
EzI2Cs_1SDA_DriveMode_2_ADDR:	equ	7h
EzI2Cs_1SDA_GlobalSelect_ADDR:	equ	6h
EzI2Cs_1SDA_IntCtrl_0_ADDR:	equ	106h
EzI2Cs_1SDA_IntCtrl_1_ADDR:	equ	107h
EzI2Cs_1SDA_IntEn_ADDR:	equ	5h
EzI2Cs_1SDA_MASK:	equ	20h
; EzI2Cs_1SDA_Data access macros
;   GetEzI2Cs_1SDA_Data macro, return in a
macro GetEzI2Cs_1SDA_Data
	mov		a,[Port_1_Data_SHADE]
	and		a, 20h
endm
;   SetEzI2Cs_1SDA_Data macro
macro SetEzI2Cs_1SDA_Data
	or		[Port_1_Data_SHADE], 20h
	mov		a, [Port_1_Data_SHADE]
	mov		reg[EzI2Cs_1SDA_Data_ADDR], a
endm
;   ClearEzI2Cs_1SDA_Data macro
macro ClearEzI2Cs_1SDA_Data
	and		[Port_1_Data_SHADE], ~20h
	mov		a, [Port_1_Data_SHADE]
	mov		reg[EzI2Cs_1SDA_Data_ADDR], a
endm

; XBL address and mask equates
XBL_Data_ADDR:	equ	4h
XBL_DriveMode_0_ADDR:	equ	104h
XBL_DriveMode_1_ADDR:	equ	105h
XBL_DriveMode_2_ADDR:	equ	7h
XBL_GlobalSelect_ADDR:	equ	6h
XBL_IntCtrl_0_ADDR:	equ	106h
XBL_IntCtrl_1_ADDR:	equ	107h
XBL_IntEn_ADDR:	equ	5h
XBL_MASK:	equ	40h
; XBL_Data access macros
;   GetXBL_Data macro, return in a
macro GetXBL_Data
	mov		a,[Port_1_Data_SHADE]
	and		a, 40h
endm
;   SetXBL_Data macro
macro SetXBL_Data
	or		[Port_1_Data_SHADE], 40h
	mov		a, [Port_1_Data_SHADE]
	mov		reg[XBL_Data_ADDR], a
endm
;   ClearXBL_Data macro
macro ClearXBL_Data
	and		[Port_1_Data_SHADE], ~40h
	mov		a, [Port_1_Data_SHADE]
	mov		reg[XBL_Data_ADDR], a
endm

; EzI2Cs_1SCL address and mask equates
EzI2Cs_1SCL_Data_ADDR:	equ	4h
EzI2Cs_1SCL_DriveMode_0_ADDR:	equ	104h
EzI2Cs_1SCL_DriveMode_1_ADDR:	equ	105h
EzI2Cs_1SCL_DriveMode_2_ADDR:	equ	7h
EzI2Cs_1SCL_GlobalSelect_ADDR:	equ	6h
EzI2Cs_1SCL_IntCtrl_0_ADDR:	equ	106h
EzI2Cs_1SCL_IntCtrl_1_ADDR:	equ	107h
EzI2Cs_1SCL_IntEn_ADDR:	equ	5h
EzI2Cs_1SCL_MASK:	equ	80h
; EzI2Cs_1SCL_Data access macros
;   GetEzI2Cs_1SCL_Data macro, return in a
macro GetEzI2Cs_1SCL_Data
	mov		a,[Port_1_Data_SHADE]
	and		a, 80h
endm
;   SetEzI2Cs_1SCL_Data macro
macro SetEzI2Cs_1SCL_Data
	or		[Port_1_Data_SHADE], 80h
	mov		a, [Port_1_Data_SHADE]
	mov		reg[EzI2Cs_1SCL_Data_ADDR], a
endm
;   ClearEzI2Cs_1SCL_Data macro
macro ClearEzI2Cs_1SCL_Data
	and		[Port_1_Data_SHADE], ~80h
	mov		a, [Port_1_Data_SHADE]
	mov		reg[EzI2Cs_1SCL_Data_ADDR], a
endm

; YAH address and mask equates
YAH_Data_ADDR:	equ	8h
YAH_DriveMode_0_ADDR:	equ	108h
YAH_DriveMode_1_ADDR:	equ	109h
YAH_DriveMode_2_ADDR:	equ	bh
YAH_GlobalSelect_ADDR:	equ	ah
YAH_IntCtrl_0_ADDR:	equ	10ah
YAH_IntCtrl_1_ADDR:	equ	10bh
YAH_IntEn_ADDR:	equ	9h
YAH_MASK:	equ	1h
; YAH_Data access macros
;   GetYAH_Data macro, return in a
macro GetYAH_Data
	mov		a,[Port_2_Data_SHADE]
	and		a, 1h
endm
;   SetYAH_Data macro
macro SetYAH_Data
	or		[Port_2_Data_SHADE], 1h
	mov		a, [Port_2_Data_SHADE]
	mov		reg[YAH_Data_ADDR], a
endm
;   ClearYAH_Data macro
macro ClearYAH_Data
	and		[Port_2_Data_SHADE], ~1h
	mov		a, [Port_2_Data_SHADE]
	mov		reg[YAH_Data_ADDR], a
endm

; YAL address and mask equates
YAL_Data_ADDR:	equ	8h
YAL_DriveMode_0_ADDR:	equ	108h
YAL_DriveMode_1_ADDR:	equ	109h
YAL_DriveMode_2_ADDR:	equ	bh
YAL_GlobalSelect_ADDR:	equ	ah
YAL_IntCtrl_0_ADDR:	equ	10ah
YAL_IntCtrl_1_ADDR:	equ	10bh
YAL_IntEn_ADDR:	equ	9h
YAL_MASK:	equ	2h
; YAL_Data access macros
;   GetYAL_Data macro, return in a
macro GetYAL_Data
	mov		a,[Port_2_Data_SHADE]
	and		a, 2h
endm
;   SetYAL_Data macro
macro SetYAL_Data
	or		[Port_2_Data_SHADE], 2h
	mov		a, [Port_2_Data_SHADE]
	mov		reg[YAL_Data_ADDR], a
endm
;   ClearYAL_Data macro
macro ClearYAL_Data
	and		[Port_2_Data_SHADE], ~2h
	mov		a, [Port_2_Data_SHADE]
	mov		reg[YAL_Data_ADDR], a
endm

; ZAH address and mask equates
ZAH_Data_ADDR:	equ	8h
ZAH_DriveMode_0_ADDR:	equ	108h
ZAH_DriveMode_1_ADDR:	equ	109h
ZAH_DriveMode_2_ADDR:	equ	bh
ZAH_GlobalSelect_ADDR:	equ	ah
ZAH_IntCtrl_0_ADDR:	equ	10ah
ZAH_IntCtrl_1_ADDR:	equ	10bh
ZAH_IntEn_ADDR:	equ	9h
ZAH_MASK:	equ	4h
; ZAH_Data access macros
;   GetZAH_Data macro, return in a
macro GetZAH_Data
	mov		a,[Port_2_Data_SHADE]
	and		a, 4h
endm
;   SetZAH_Data macro
macro SetZAH_Data
	or		[Port_2_Data_SHADE], 4h
	mov		a, [Port_2_Data_SHADE]
	mov		reg[ZAH_Data_ADDR], a
endm
;   ClearZAH_Data macro
macro ClearZAH_Data
	and		[Port_2_Data_SHADE], ~4h
	mov		a, [Port_2_Data_SHADE]
	mov		reg[ZAH_Data_ADDR], a
endm

; YBH address and mask equates
YBH_Data_ADDR:	equ	8h
YBH_DriveMode_0_ADDR:	equ	108h
YBH_DriveMode_1_ADDR:	equ	109h
YBH_DriveMode_2_ADDR:	equ	bh
YBH_GlobalSelect_ADDR:	equ	ah
YBH_IntCtrl_0_ADDR:	equ	10ah
YBH_IntCtrl_1_ADDR:	equ	10bh
YBH_IntEn_ADDR:	equ	9h
YBH_MASK:	equ	8h
; YBH_Data access macros
;   GetYBH_Data macro, return in a
macro GetYBH_Data
	mov		a,[Port_2_Data_SHADE]
	and		a, 8h
endm
;   SetYBH_Data macro
macro SetYBH_Data
	or		[Port_2_Data_SHADE], 8h
	mov		a, [Port_2_Data_SHADE]
	mov		reg[YBH_Data_ADDR], a
endm
;   ClearYBH_Data macro
macro ClearYBH_Data
	and		[Port_2_Data_SHADE], ~8h
	mov		a, [Port_2_Data_SHADE]
	mov		reg[YBH_Data_ADDR], a
endm

; AGND address and mask equates
AGND_Data_ADDR:	equ	8h
AGND_DriveMode_0_ADDR:	equ	108h
AGND_DriveMode_1_ADDR:	equ	109h
AGND_DriveMode_2_ADDR:	equ	bh
AGND_GlobalSelect_ADDR:	equ	ah
AGND_IntCtrl_0_ADDR:	equ	10ah
AGND_IntCtrl_1_ADDR:	equ	10bh
AGND_IntEn_ADDR:	equ	9h
AGND_MASK:	equ	10h
; AGND_Data access macros
;   GetAGND_Data macro, return in a
macro GetAGND_Data
	mov		a,[Port_2_Data_SHADE]
	and		a, 10h
endm
;   SetAGND_Data macro
macro SetAGND_Data
	or		[Port_2_Data_SHADE], 10h
	mov		a, [Port_2_Data_SHADE]
	mov		reg[AGND_Data_ADDR], a
endm
;   ClearAGND_Data macro
macro ClearAGND_Data
	and		[Port_2_Data_SHADE], ~10h
	mov		a, [Port_2_Data_SHADE]
	mov		reg[AGND_Data_ADDR], a
endm

; YBL address and mask equates
YBL_Data_ADDR:	equ	8h
YBL_DriveMode_0_ADDR:	equ	108h
YBL_DriveMode_1_ADDR:	equ	109h
YBL_DriveMode_2_ADDR:	equ	bh
YBL_GlobalSelect_ADDR:	equ	ah
YBL_IntCtrl_0_ADDR:	equ	10ah
YBL_IntCtrl_1_ADDR:	equ	10bh
YBL_IntEn_ADDR:	equ	9h
YBL_MASK:	equ	20h
; YBL_Data access macros
;   GetYBL_Data macro, return in a
macro GetYBL_Data
	mov		a,[Port_2_Data_SHADE]
	and		a, 20h
endm
;   SetYBL_Data macro
macro SetYBL_Data
	or		[Port_2_Data_SHADE], 20h
	mov		a, [Port_2_Data_SHADE]
	mov		reg[YBL_Data_ADDR], a
endm
;   ClearYBL_Data macro
macro ClearYBL_Data
	and		[Port_2_Data_SHADE], ~20h
	mov		a, [Port_2_Data_SHADE]
	mov		reg[YBL_Data_ADDR], a
endm

; ZBH address and mask equates
ZBH_Data_ADDR:	equ	8h
ZBH_DriveMode_0_ADDR:	equ	108h
ZBH_DriveMode_1_ADDR:	equ	109h
ZBH_DriveMode_2_ADDR:	equ	bh
ZBH_GlobalSelect_ADDR:	equ	ah
ZBH_IntCtrl_0_ADDR:	equ	10ah
ZBH_IntCtrl_1_ADDR:	equ	10bh
ZBH_IntEn_ADDR:	equ	9h
ZBH_MASK:	equ	40h
; ZBH_Data access macros
;   GetZBH_Data macro, return in a
macro GetZBH_Data
	mov		a,[Port_2_Data_SHADE]
	and		a, 40h
endm
;   SetZBH_Data macro
macro SetZBH_Data
	or		[Port_2_Data_SHADE], 40h
	mov		a, [Port_2_Data_SHADE]
	mov		reg[ZBH_Data_ADDR], a
endm
;   ClearZBH_Data macro
macro ClearZBH_Data
	and		[Port_2_Data_SHADE], ~40h
	mov		a, [Port_2_Data_SHADE]
	mov		reg[ZBH_Data_ADDR], a
endm

; ZAL address and mask equates
ZAL_Data_ADDR:	equ	8h
ZAL_DriveMode_0_ADDR:	equ	108h
ZAL_DriveMode_1_ADDR:	equ	109h
ZAL_DriveMode_2_ADDR:	equ	bh
ZAL_GlobalSelect_ADDR:	equ	ah
ZAL_IntCtrl_0_ADDR:	equ	10ah
ZAL_IntCtrl_1_ADDR:	equ	10bh
ZAL_IntEn_ADDR:	equ	9h
ZAL_MASK:	equ	80h
; ZAL_Data access macros
;   GetZAL_Data macro, return in a
macro GetZAL_Data
	mov		a,[Port_2_Data_SHADE]
	and		a, 80h
endm
;   SetZAL_Data macro
macro SetZAL_Data
	or		[Port_2_Data_SHADE], 80h
	mov		a, [Port_2_Data_SHADE]
	mov		reg[ZAL_Data_ADDR], a
endm
;   ClearZAL_Data macro
macro ClearZAL_Data
	and		[Port_2_Data_SHADE], ~80h
	mov		a, [Port_2_Data_SHADE]
	mov		reg[ZAL_Data_ADDR], a
endm

