;;*****************************************************************************
;;*****************************************************************************
;;  FILENAME: PRS32_Y.inc
;;   Version: 3.4, Updated on 2013/5/19 at 10:44:2
;;  Generated by PSoC Designer 5.4.2946
;;
;;  DESCRIPTION: Assembler declarations for the PRS32 user module interface.
;;-----------------------------------------------------------------------------
;;  Copyright (c) Cypress Semiconductor 2013. All Rights Reserved.
;;*****************************************************************************
;;*****************************************************************************

include "m8c.inc"

;--------------------------------------------------
; Register Address Constants for PRS32_Y
;--------------------------------------------------
PRS32_Y_CONTROL_REG_LSB:    equ 43h              ;Control register LSB
PRS32_Y_CONTROL_REG_ISB1:   equ 47h              ;Control register ISB1
PRS32_Y_CONTROL_REG_ISB2:   equ 4bh              ;Control register ISB2
PRS32_Y_CONTROL_REG_MSB:    equ 4fh              ;Control register MSB
PRS32_Y_SHIFT_REG_LSB:  equ 40h                  ;Shift register LSB
PRS32_Y_SHIFT_REG_ISB1: equ 44h                  ;Shift register ISB1
PRS32_Y_SHIFT_REG_ISB2: equ 48h                  ;Shift register ISB2
PRS32_Y_SHIFT_REG_MSB:  equ 4ch                  ;Shift register MSB
PRS32_Y_POLY_REG_LSB:   equ 41h                  ;Polynomial register LSB
PRS32_Y_POLY_REG_ISB1:  equ 45h                  ;Polynomial register ISB1
PRS32_Y_POLY_REG_ISB2:  equ 49h                  ;Polynomial register ISB2
PRS32_Y_POLY_REG_MSB:   equ 4dh                  ;Polynomial register MSB
PRS32_Y_SEED_REG_LSB:   equ 42h                  ;Seed register LSB
PRS32_Y_SEED_REG_ISB1:  equ 46h                  ;Seed register ISB1
PRS32_Y_SEED_REG_ISB2:  equ 4ah                  ;Seed register ISB2
PRS32_Y_SEED_REG_MSB:   equ 4eh                  ;Seed register MSB
PRS32_Y_FUNC_REG_LSB:   equ 40h                  ;Function register LSB
PRS32_Y_FUNC_REG_ISB1:  equ 44h                  ;Function register ISB1
PRS32_Y_FUNC_REG_ISB2:  equ 48h                  ;Function register ISB2
PRS32_Y_FUNC_REG_MSB:   equ 4ch                  ;Function register MSB
PRS32_Y_INPUT_REG_LSB:  equ 41h                  ;Input register LSB
PRS32_Y_INPUT_REG_ISB1: equ 45h                  ;Input register ISB1
PRS32_Y_INPUT_REG_ISB2: equ 49h                  ;Input register ISB2
PRS32_Y_INPUT_REG_MSB:  equ 4dh                  ;Input register MSB
PRS32_Y_OUTPUT_REG_LSB: equ 42h                  ;Output register LSB
PRS32_Y_OUTPUT_REG_ISB1:    equ 46h              ;Output register ISB1
PRS32_Y_OUTPUT_REG_ISB2:    equ 4ah              ;Output register ISB2
PRS32_Y_OUTPUT_REG_MSB: equ 4eh                  ;Output register MSB

; end of file PRS32_Y.inc
