;;*****************************************************************************
;;*****************************************************************************
;;  FILENAME: PRS32_Z.inc
;;   Version: 3.4, Updated on 2013/5/19 at 10:44:2
;;  Generated by PSoC Designer 5.4.2946
;;
;;  DESCRIPTION: Assembler declarations for the PRS32 user module interface.
;;-----------------------------------------------------------------------------
;;  Copyright (c) Cypress Semiconductor 2013. All Rights Reserved.
;;*****************************************************************************
;;*****************************************************************************

include "m8c.inc"

;--------------------------------------------------
; Register Address Constants for PRS32_Z
;--------------------------------------------------
PRS32_Z_CONTROL_REG_LSB:    equ 53h              ;Control register LSB
PRS32_Z_CONTROL_REG_ISB1:   equ 57h              ;Control register ISB1
PRS32_Z_CONTROL_REG_ISB2:   equ 5bh              ;Control register ISB2
PRS32_Z_CONTROL_REG_MSB:    equ 5fh              ;Control register MSB
PRS32_Z_SHIFT_REG_LSB:  equ 50h                  ;Shift register LSB
PRS32_Z_SHIFT_REG_ISB1: equ 54h                  ;Shift register ISB1
PRS32_Z_SHIFT_REG_ISB2: equ 58h                  ;Shift register ISB2
PRS32_Z_SHIFT_REG_MSB:  equ 5ch                  ;Shift register MSB
PRS32_Z_POLY_REG_LSB:   equ 51h                  ;Polynomial register LSB
PRS32_Z_POLY_REG_ISB1:  equ 55h                  ;Polynomial register ISB1
PRS32_Z_POLY_REG_ISB2:  equ 59h                  ;Polynomial register ISB2
PRS32_Z_POLY_REG_MSB:   equ 5dh                  ;Polynomial register MSB
PRS32_Z_SEED_REG_LSB:   equ 52h                  ;Seed register LSB
PRS32_Z_SEED_REG_ISB1:  equ 56h                  ;Seed register ISB1
PRS32_Z_SEED_REG_ISB2:  equ 5ah                  ;Seed register ISB2
PRS32_Z_SEED_REG_MSB:   equ 5eh                  ;Seed register MSB
PRS32_Z_FUNC_REG_LSB:   equ 50h                  ;Function register LSB
PRS32_Z_FUNC_REG_ISB1:  equ 54h                  ;Function register ISB1
PRS32_Z_FUNC_REG_ISB2:  equ 58h                  ;Function register ISB2
PRS32_Z_FUNC_REG_MSB:   equ 5ch                  ;Function register MSB
PRS32_Z_INPUT_REG_LSB:  equ 51h                  ;Input register LSB
PRS32_Z_INPUT_REG_ISB1: equ 55h                  ;Input register ISB1
PRS32_Z_INPUT_REG_ISB2: equ 59h                  ;Input register ISB2
PRS32_Z_INPUT_REG_MSB:  equ 5dh                  ;Input register MSB
PRS32_Z_OUTPUT_REG_LSB: equ 52h                  ;Output register LSB
PRS32_Z_OUTPUT_REG_ISB1:    equ 56h              ;Output register ISB1
PRS32_Z_OUTPUT_REG_ISB2:    equ 5ah              ;Output register ISB2
PRS32_Z_OUTPUT_REG_MSB: equ 5eh                  ;Output register MSB

; end of file PRS32_Z.inc
