;;*****************************************************************************
;;*****************************************************************************
;;  FILENAME: Timer16_1.inc
;;   Version: 2.6, Updated on 2013/5/19 at 10:44:39
;;  Generated by PSoC Designer 5.4.2946
;;
;;  DESCRIPTION: Assembler declarations for the Timer16 user module interface
;;-----------------------------------------------------------------------------
;;  Copyright (c) Cypress Semiconductor 2013. All Rights Reserved.
;;*****************************************************************************
;;*****************************************************************************

include "m8c.inc"


;--------------------------------------------------
; Constants for Timer16_1 API's.
;--------------------------------------------------

Timer16_1_CONTROL_REG_START_BIT:           equ 0x01    ; Control register start bit
Timer16_1_INT_REG:                         equ 0x0e1
Timer16_1_INT_MASK:                        equ 0x02


;--------------------------------------------------
; Constants for Timer16_1 user defined values
;--------------------------------------------------

Timer16_1_PERIOD:                          equ 0x3fff
Timer16_1_COMPARE_VALUE:                   equ 0x0


;--------------------------------------------------
; Register Address Constants for Timer16_1
;--------------------------------------------------

Timer16_1_COUNTER_LSB_REG:             equ 0x20   ; DR0 Counter register
Timer16_1_COUNTER_MSB_REG:             equ 0x24
Timer16_1_PERIOD_LSB_REG:              equ 0x21   ; DR1 Period register
Timer16_1_PERIOD_MSB_REG:              equ 0x25
Timer16_1_COMPARE_LSB_REG:             equ 0x22   ; DR2 CompareValue register
Timer16_1_COMPARE_MSB_REG:             equ 0x26
Timer16_1_CONTROL_LSB_REG:             equ 0x23   ; Control register
Timer16_1_CONTROL_MSB_REG:             equ 0x27
Timer16_1_FUNC_LSB_REG:                equ 0x20   ; Function register
Timer16_1_FUNC_MSB_REG:                equ 0x24
Timer16_1_INPUT_LSB_REG:               equ 0x21   ; Input register
Timer16_1_INPUT_MSB_REG:               equ 0x25
Timer16_1_OUTPUT_LSB_REG:              equ 0x22   ; Output register
Timer16_1_OUTPUT_MSB_REG:              equ 0x26


;--------------------------------------------------
; Timer16_1 Macro 'Functions'
;--------------------------------------------------

   macro Timer16_1_Start_M
   or    reg[Timer16_1_CONTROL_LSB_REG],  Timer16_1_CONTROL_REG_START_BIT
   endm

   macro Timer16_1_Stop_M
   and   reg[Timer16_1_CONTROL_LSB_REG], ~Timer16_1_CONTROL_REG_START_BIT
   endm

   macro Timer16_1_EnableInt_M
   M8C_EnableIntMask Timer16_1_INT_REG, Timer16_1_INT_MASK
   endm

   macro Timer16_1_DisableInt_M
   M8C_DisableIntMask Timer16_1_INT_REG, Timer16_1_INT_MASK
   endm


; end of file Timer16_1.inc
