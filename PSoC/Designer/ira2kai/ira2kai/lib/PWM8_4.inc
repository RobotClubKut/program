;;*****************************************************************************
;;*****************************************************************************
;;  FILENAME: PWM8_4.inc
;;   Version: 2.60, Updated on 2013/5/19 at 10:44:7
;;  Generated by PSoC Designer 5.4.2946
;;
;;  DESCRIPTION: Assembler declarations for the PWM8 user module interface
;;-----------------------------------------------------------------------------
;;  Copyright (c) Cypress Semiconductor 2013. All Rights Reserved.
;;*****************************************************************************
;;*****************************************************************************

include "m8c.inc"


;--------------------------------------------------
; Constants for PWM8_4 API's.
;--------------------------------------------------

PWM8_4_CONTROL_REG_START_BIT:              equ 0x01    ; Control register start bit
PWM8_4_INT_REG:                            equ 0x0df
PWM8_4_INT_MASK:                           equ 0x01


;--------------------------------------------------
; Constants for PWM8_4 user defined values
;--------------------------------------------------

PWM8_4_PERIOD:                             equ 0xff
PWM8_4_PULSE_WIDTH:                        equ 0x00


;--------------------------------------------------
; Register Address Constants for PWM8_4
;--------------------------------------------------

PWM8_4_COUNTER_REG:                    equ 0x40   ; DR0 Count register
PWM8_4_PERIOD_REG:                     equ 0x41   ; DR1 Period register
PWM8_4_COMPARE_REG:                    equ 0x42   ; DR2 Compare register
PWM8_4_CONTROL_REG:                    equ 0x43   ; Control register
PWM8_4_FUNC_REG:                       equ 0x40   ; Function register
PWM8_4_INPUT_REG:                      equ 0x41   ; Input register
PWM8_4_OUTPUT_REG:                     equ 0x42   ; Output register


;--------------------------------------------------
; PWM8_4 Macro 'Functions'
;--------------------------------------------------

   macro PWM8_4_Start_M
   or    reg[PWM8_4_CONTROL_REG],  PWM8_4_CONTROL_REG_START_BIT
   endm

   macro PWM8_4_Stop_M
   and   reg[PWM8_4_CONTROL_REG], ~PWM8_4_CONTROL_REG_START_BIT
   endm

   macro PWM8_4_EnableInt_M
   M8C_EnableIntMask PWM8_4_INT_REG, PWM8_4_INT_MASK
   endm

   macro PWM8_4_DisableInt_M
   M8C_DisableIntMask PWM8_4_INT_REG, PWM8_4_INT_MASK
   endm


; end of file PWM8_4.inc
