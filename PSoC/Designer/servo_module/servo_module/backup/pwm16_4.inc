;;*****************************************************************************
;;*****************************************************************************
;;  FILENAME: PWM16_4.inc
;;   Version: 2.5, Updated on 2013/5/19 at 10:44:6
;;  Generated by PSoC Designer 5.4.2946
;;
;;  DESCRIPTION: Assembler declarations for the PWM16 user module interface
;;-----------------------------------------------------------------------------
;;  Copyright (c) Cypress Semiconductor 2013. All Rights Reserved.
;;*****************************************************************************
;;*****************************************************************************

include "m8c.inc"


;--------------------------------------------------
; Constants for PWM16_4 API's.
;--------------------------------------------------

PWM16_4_CONTROL_REG_START_BIT:             equ 0x01    ; Control register start bit
PWM16_4_INT_REG:                           equ 0x0e1
PWM16_4_INT_MASK:                          equ 0x80


;--------------------------------------------------
; Constants for PWM16_4 user defined values
;--------------------------------------------------

PWM16_4_PERIOD:                            equ 0x5dbf
PWM16_4_PULSE_WIDTH:                       equ 0x4af


;--------------------------------------------------
; Register Address Constants for PWM16_4
;--------------------------------------------------

PWM16_4_COUNTER_LSB_REG:               equ 0x38   ; DR0 Count register
PWM16_4_COUNTER_MSB_REG:               equ 0x3c
PWM16_4_PERIOD_LSB_REG:                equ 0x39   ; DR1 Period register
PWM16_4_PERIOD_MSB_REG:                equ 0x3d
PWM16_4_COMPARE_LSB_REG:               equ 0x3a   ; DR2 Compare register
PWM16_4_COMPARE_MSB_REG:               equ 0x3e
PWM16_4_CONTROL_LSB_REG:               equ 0x3b   ; Control register
PWM16_4_CONTROL_MSB_REG:               equ 0x3f
PWM16_4_FUNC_LSB_REG:                  equ 0x38   ; Function register
PWM16_4_FUNC_MSB_REG:                  equ 0x3c
PWM16_4_INPUT_LSB_REG:                 equ 0x39   ; Input register
PWM16_4_INPUT_MSB_REG:                 equ 0x3d
PWM16_4_OUTPUT_LSB_REG:                equ 0x3a   ; Output register
PWM16_4_OUTPUT_MSB_REG:                equ 0x3e


;--------------------------------------------------
; PWM16_4 Macro 'Functions'
;--------------------------------------------------

   macro PWM16_4_Start_M
   or    reg[PWM16_4_CONTROL_LSB_REG],  PWM16_4_CONTROL_REG_START_BIT
   endm

   macro PWM16_4_Stop_M
   and   reg[PWM16_4_CONTROL_LSB_REG], ~PWM16_4_CONTROL_REG_START_BIT
   endm

   macro PWM16_4_EnableInt_M
   M8C_EnableIntMask PWM16_4_INT_REG, PWM16_4_INT_MASK
   endm

   macro PWM16_4_DisableInt_M
   M8C_DisableIntMask PWM16_4_INT_REG, PWM16_4_INT_MASK
   endm


; end of file PWM16_4.inc

