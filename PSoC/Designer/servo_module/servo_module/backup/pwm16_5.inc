;;*****************************************************************************
;;*****************************************************************************
;;  FILENAME: PWM16_5.inc
;;   Version: 2.5, Updated on 2013/5/19 at 10:44:6
;;  Generated by PSoC Designer 5.4.2946
;;
;;  DESCRIPTION: Assembler declarations for the PWM16 user module interface
;;-----------------------------------------------------------------------------
;;  Copyright (c) Cypress Semiconductor 2013. All Rights Reserved.
;;*****************************************************************************
;;*****************************************************************************

include "m8c.inc"


;--------------------------------------------------
; Constants for PWM16_5 API's.
;--------------------------------------------------

PWM16_5_CONTROL_REG_START_BIT:             equ 0x01    ; Control register start bit
PWM16_5_INT_REG:                           equ 0x0df
PWM16_5_INT_MASK:                          equ 0x02


;--------------------------------------------------
; Constants for PWM16_5 user defined values
;--------------------------------------------------

PWM16_5_PERIOD:                            equ 0x5dbf
PWM16_5_PULSE_WIDTH:                       equ 0x4af


;--------------------------------------------------
; Register Address Constants for PWM16_5
;--------------------------------------------------

PWM16_5_COUNTER_LSB_REG:               equ 0x40   ; DR0 Count register
PWM16_5_COUNTER_MSB_REG:               equ 0x44
PWM16_5_PERIOD_LSB_REG:                equ 0x41   ; DR1 Period register
PWM16_5_PERIOD_MSB_REG:                equ 0x45
PWM16_5_COMPARE_LSB_REG:               equ 0x42   ; DR2 Compare register
PWM16_5_COMPARE_MSB_REG:               equ 0x46
PWM16_5_CONTROL_LSB_REG:               equ 0x43   ; Control register
PWM16_5_CONTROL_MSB_REG:               equ 0x47
PWM16_5_FUNC_LSB_REG:                  equ 0x40   ; Function register
PWM16_5_FUNC_MSB_REG:                  equ 0x44
PWM16_5_INPUT_LSB_REG:                 equ 0x41   ; Input register
PWM16_5_INPUT_MSB_REG:                 equ 0x45
PWM16_5_OUTPUT_LSB_REG:                equ 0x42   ; Output register
PWM16_5_OUTPUT_MSB_REG:                equ 0x46


;--------------------------------------------------
; PWM16_5 Macro 'Functions'
;--------------------------------------------------

   macro PWM16_5_Start_M
   or    reg[PWM16_5_CONTROL_LSB_REG],  PWM16_5_CONTROL_REG_START_BIT
   endm

   macro PWM16_5_Stop_M
   and   reg[PWM16_5_CONTROL_LSB_REG], ~PWM16_5_CONTROL_REG_START_BIT
   endm

   macro PWM16_5_EnableInt_M
   M8C_EnableIntMask PWM16_5_INT_REG, PWM16_5_INT_MASK
   endm

   macro PWM16_5_DisableInt_M
   M8C_DisableIntMask PWM16_5_INT_REG, PWM16_5_INT_MASK
   endm


; end of file PWM16_5.inc

