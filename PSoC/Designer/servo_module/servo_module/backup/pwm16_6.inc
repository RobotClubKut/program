;;*****************************************************************************
;;*****************************************************************************
;;  FILENAME: PWM16_6.inc
;;   Version: 2.5, Updated on 2013/5/19 at 10:44:6
;;  Generated by PSoC Designer 5.4.2946
;;
;;  DESCRIPTION: Assembler declarations for the PWM16 user module interface
;;-----------------------------------------------------------------------------
;;  Copyright (c) Cypress Semiconductor 2013. All Rights Reserved.
;;*****************************************************************************
;;*****************************************************************************

include "m8c.inc"


;--------------------------------------------------
; Constants for PWM16_6 API's.
;--------------------------------------------------

PWM16_6_CONTROL_REG_START_BIT:             equ 0x01    ; Control register start bit
PWM16_6_INT_REG:                           equ 0x0df
PWM16_6_INT_MASK:                          equ 0x08


;--------------------------------------------------
; Constants for PWM16_6 user defined values
;--------------------------------------------------

PWM16_6_PERIOD:                            equ 0x5dbf
PWM16_6_PULSE_WIDTH:                       equ 0x4af


;--------------------------------------------------
; Register Address Constants for PWM16_6
;--------------------------------------------------

PWM16_6_COUNTER_LSB_REG:               equ 0x48   ; DR0 Count register
PWM16_6_COUNTER_MSB_REG:               equ 0x4c
PWM16_6_PERIOD_LSB_REG:                equ 0x49   ; DR1 Period register
PWM16_6_PERIOD_MSB_REG:                equ 0x4d
PWM16_6_COMPARE_LSB_REG:               equ 0x4a   ; DR2 Compare register
PWM16_6_COMPARE_MSB_REG:               equ 0x4e
PWM16_6_CONTROL_LSB_REG:               equ 0x4b   ; Control register
PWM16_6_CONTROL_MSB_REG:               equ 0x4f
PWM16_6_FUNC_LSB_REG:                  equ 0x48   ; Function register
PWM16_6_FUNC_MSB_REG:                  equ 0x4c
PWM16_6_INPUT_LSB_REG:                 equ 0x49   ; Input register
PWM16_6_INPUT_MSB_REG:                 equ 0x4d
PWM16_6_OUTPUT_LSB_REG:                equ 0x4a   ; Output register
PWM16_6_OUTPUT_MSB_REG:                equ 0x4e


;--------------------------------------------------
; PWM16_6 Macro 'Functions'
;--------------------------------------------------

   macro PWM16_6_Start_M
   or    reg[PWM16_6_CONTROL_LSB_REG],  PWM16_6_CONTROL_REG_START_BIT
   endm

   macro PWM16_6_Stop_M
   and   reg[PWM16_6_CONTROL_LSB_REG], ~PWM16_6_CONTROL_REG_START_BIT
   endm

   macro PWM16_6_EnableInt_M
   M8C_EnableIntMask PWM16_6_INT_REG, PWM16_6_INT_MASK
   endm

   macro PWM16_6_DisableInt_M
   M8C_DisableIntMask PWM16_6_INT_REG, PWM16_6_INT_MASK
   endm


; end of file PWM16_6.inc

