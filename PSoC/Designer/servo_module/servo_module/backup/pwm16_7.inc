;;*****************************************************************************
;;*****************************************************************************
;;  FILENAME: PWM16_7.inc
;;   Version: 2.5, Updated on 2013/5/19 at 10:44:6
;;  Generated by PSoC Designer 5.4.2946
;;
;;  DESCRIPTION: Assembler declarations for the PWM16 user module interface
;;-----------------------------------------------------------------------------
;;  Copyright (c) Cypress Semiconductor 2013. All Rights Reserved.
;;*****************************************************************************
;;*****************************************************************************

include "m8c.inc"


;--------------------------------------------------
; Constants for PWM16_7 API's.
;--------------------------------------------------

PWM16_7_CONTROL_REG_START_BIT:             equ 0x01    ; Control register start bit
PWM16_7_INT_REG:                           equ 0x0df
PWM16_7_INT_MASK:                          equ 0x20


;--------------------------------------------------
; Constants for PWM16_7 user defined values
;--------------------------------------------------

PWM16_7_PERIOD:                            equ 0x5dbf
PWM16_7_PULSE_WIDTH:                       equ 0x4af


;--------------------------------------------------
; Register Address Constants for PWM16_7
;--------------------------------------------------

PWM16_7_COUNTER_LSB_REG:               equ 0x50   ; DR0 Count register
PWM16_7_COUNTER_MSB_REG:               equ 0x54
PWM16_7_PERIOD_LSB_REG:                equ 0x51   ; DR1 Period register
PWM16_7_PERIOD_MSB_REG:                equ 0x55
PWM16_7_COMPARE_LSB_REG:               equ 0x52   ; DR2 Compare register
PWM16_7_COMPARE_MSB_REG:               equ 0x56
PWM16_7_CONTROL_LSB_REG:               equ 0x53   ; Control register
PWM16_7_CONTROL_MSB_REG:               equ 0x57
PWM16_7_FUNC_LSB_REG:                  equ 0x50   ; Function register
PWM16_7_FUNC_MSB_REG:                  equ 0x54
PWM16_7_INPUT_LSB_REG:                 equ 0x51   ; Input register
PWM16_7_INPUT_MSB_REG:                 equ 0x55
PWM16_7_OUTPUT_LSB_REG:                equ 0x52   ; Output register
PWM16_7_OUTPUT_MSB_REG:                equ 0x56


;--------------------------------------------------
; PWM16_7 Macro 'Functions'
;--------------------------------------------------

   macro PWM16_7_Start_M
   or    reg[PWM16_7_CONTROL_LSB_REG],  PWM16_7_CONTROL_REG_START_BIT
   endm

   macro PWM16_7_Stop_M
   and   reg[PWM16_7_CONTROL_LSB_REG], ~PWM16_7_CONTROL_REG_START_BIT
   endm

   macro PWM16_7_EnableInt_M
   M8C_EnableIntMask PWM16_7_INT_REG, PWM16_7_INT_MASK
   endm

   macro PWM16_7_DisableInt_M
   M8C_DisableIntMask PWM16_7_INT_REG, PWM16_7_INT_MASK
   endm


; end of file PWM16_7.inc

