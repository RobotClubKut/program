;;*****************************************************************************
;;*****************************************************************************
;;  FILENAME: PWM16_8.inc
;;   Version: 2.5, Updated on 2013/5/19 at 10:44:6
;;  Generated by PSoC Designer 5.4.2946
;;
;;  DESCRIPTION: Assembler declarations for the PWM16 user module interface
;;-----------------------------------------------------------------------------
;;  Copyright (c) Cypress Semiconductor 2013. All Rights Reserved.
;;*****************************************************************************
;;*****************************************************************************

include "m8c.inc"


;--------------------------------------------------
; Constants for PWM16_8 API's.
;--------------------------------------------------

PWM16_8_CONTROL_REG_START_BIT:             equ 0x01    ; Control register start bit
PWM16_8_INT_REG:                           equ 0x0df
PWM16_8_INT_MASK:                          equ 0x80


;--------------------------------------------------
; Constants for PWM16_8 user defined values
;--------------------------------------------------

PWM16_8_PERIOD:                            equ 0x5dbf
PWM16_8_PULSE_WIDTH:                       equ 0x4af


;--------------------------------------------------
; Register Address Constants for PWM16_8
;--------------------------------------------------

PWM16_8_COUNTER_LSB_REG:               equ 0x58   ; DR0 Count register
PWM16_8_COUNTER_MSB_REG:               equ 0x5c
PWM16_8_PERIOD_LSB_REG:                equ 0x59   ; DR1 Period register
PWM16_8_PERIOD_MSB_REG:                equ 0x5d
PWM16_8_COMPARE_LSB_REG:               equ 0x5a   ; DR2 Compare register
PWM16_8_COMPARE_MSB_REG:               equ 0x5e
PWM16_8_CONTROL_LSB_REG:               equ 0x5b   ; Control register
PWM16_8_CONTROL_MSB_REG:               equ 0x5f
PWM16_8_FUNC_LSB_REG:                  equ 0x58   ; Function register
PWM16_8_FUNC_MSB_REG:                  equ 0x5c
PWM16_8_INPUT_LSB_REG:                 equ 0x59   ; Input register
PWM16_8_INPUT_MSB_REG:                 equ 0x5d
PWM16_8_OUTPUT_LSB_REG:                equ 0x5a   ; Output register
PWM16_8_OUTPUT_MSB_REG:                equ 0x5e


;--------------------------------------------------
; PWM16_8 Macro 'Functions'
;--------------------------------------------------

   macro PWM16_8_Start_M
   or    reg[PWM16_8_CONTROL_LSB_REG],  PWM16_8_CONTROL_REG_START_BIT
   endm

   macro PWM16_8_Stop_M
   and   reg[PWM16_8_CONTROL_LSB_REG], ~PWM16_8_CONTROL_REG_START_BIT
   endm

   macro PWM16_8_EnableInt_M
   M8C_EnableIntMask PWM16_8_INT_REG, PWM16_8_INT_MASK
   endm

   macro PWM16_8_DisableInt_M
   M8C_DisableIntMask PWM16_8_INT_REG, PWM16_8_INT_MASK
   endm


; end of file PWM16_8.inc

