;  Generated by PSoC Designer 5.4.2946
;
; =============================================================================
; FILENAME: PSoCAPI.inc
;  
; Copyright (c) Cypress Semiconductor 2013. All Rights Reserved.
;  
; NOTES:
; Do not modify this file. It is generated by PSoC Designer each time the
; generate application function is run. The values of the parameters in this
; file can be modified by changing the values of the global parameters in the
; device editor.
;  
; =============================================================================
 
include "PSoCGPIOINT.inc"
include "EzI2Cs_1.inc"
include "LCD_1.inc"
include "PWM16_1.inc"
include "PWM16_2.inc"
include "PWM16_3.inc"
include "PWM16_4.inc"
include "PWM16_5.inc"
include "PWM16_6.inc"
include "PWM16_7.inc"
include "PWM16_8.inc"
