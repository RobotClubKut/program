;;*****************************************************************************
;;*****************************************************************************
;;  FILENAME: PWM16_2.inc
;;   Version: 2.5, Updated on 2013/5/19 at 10:44:6
;;  Generated by PSoC Designer 5.4.2946
;;
;;  DESCRIPTION: Assembler declarations for the PWM16 user module interface
;;-----------------------------------------------------------------------------
;;  Copyright (c) Cypress Semiconductor 2013. All Rights Reserved.
;;*****************************************************************************
;;*****************************************************************************

include "m8c.inc"


;--------------------------------------------------
; Constants for PWM16_2 API's.
;--------------------------------------------------

PWM16_2_CONTROL_REG_START_BIT:             equ 0x01    ; Control register start bit
PWM16_2_INT_REG:                           equ 0x0e1
PWM16_2_INT_MASK:                          equ 0x08


;--------------------------------------------------
; Constants for PWM16_2 user defined values
;--------------------------------------------------

PWM16_2_PERIOD:                            equ 0x5dbf
PWM16_2_PULSE_WIDTH:                       equ 0x5dc


;--------------------------------------------------
; Register Address Constants for PWM16_2
;--------------------------------------------------

PWM16_2_COUNTER_LSB_REG:               equ 0x28   ; DR0 Count register
PWM16_2_COUNTER_MSB_REG:               equ 0x2c
PWM16_2_PERIOD_LSB_REG:                equ 0x29   ; DR1 Period register
PWM16_2_PERIOD_MSB_REG:                equ 0x2d
PWM16_2_COMPARE_LSB_REG:               equ 0x2a   ; DR2 Compare register
PWM16_2_COMPARE_MSB_REG:               equ 0x2e
PWM16_2_CONTROL_LSB_REG:               equ 0x2b   ; Control register
PWM16_2_CONTROL_MSB_REG:               equ 0x2f
PWM16_2_FUNC_LSB_REG:                  equ 0x28   ; Function register
PWM16_2_FUNC_MSB_REG:                  equ 0x2c
PWM16_2_INPUT_LSB_REG:                 equ 0x29   ; Input register
PWM16_2_INPUT_MSB_REG:                 equ 0x2d
PWM16_2_OUTPUT_LSB_REG:                equ 0x2a   ; Output register
PWM16_2_OUTPUT_MSB_REG:                equ 0x2e


;--------------------------------------------------
; PWM16_2 Macro 'Functions'
;--------------------------------------------------

   macro PWM16_2_Start_M
   or    reg[PWM16_2_CONTROL_LSB_REG],  PWM16_2_CONTROL_REG_START_BIT
   endm

   macro PWM16_2_Stop_M
   and   reg[PWM16_2_CONTROL_LSB_REG], ~PWM16_2_CONTROL_REG_START_BIT
   endm

   macro PWM16_2_EnableInt_M
   M8C_EnableIntMask PWM16_2_INT_REG, PWM16_2_INT_MASK
   endm

   macro PWM16_2_DisableInt_M
   M8C_DisableIntMask PWM16_2_INT_REG, PWM16_2_INT_MASK
   endm


; end of file PWM16_2.inc

