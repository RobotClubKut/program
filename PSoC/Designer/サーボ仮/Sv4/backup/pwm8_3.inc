;;*****************************************************************************
;;*****************************************************************************
;;  FILENAME: PWM8_3.inc
;;   Version: 2.60, Updated on 2013/5/19 at 10:44:7
;;  Generated by PSoC Designer 5.4.2946
;;
;;  DESCRIPTION: Assembler declarations for the PWM8 user module interface
;;-----------------------------------------------------------------------------
;;  Copyright (c) Cypress Semiconductor 2013. All Rights Reserved.
;;*****************************************************************************
;;*****************************************************************************

include "m8c.inc"


;--------------------------------------------------
; Constants for PWM8_3 API's.
;--------------------------------------------------

PWM8_3_CONTROL_REG_START_BIT:              equ 0x01    ; Control register start bit
PWM8_3_INT_REG:                            equ 0x0e1
PWM8_3_INT_MASK:                           equ 0x04


;--------------------------------------------------
; Constants for PWM8_3 user defined values
;--------------------------------------------------

PWM8_3_PERIOD:                             equ 0xff
PWM8_3_PULSE_WIDTH:                        equ 0x00


;--------------------------------------------------
; Register Address Constants for PWM8_3
;--------------------------------------------------

PWM8_3_COUNTER_REG:                    equ 0x28   ; DR0 Count register
PWM8_3_PERIOD_REG:                     equ 0x29   ; DR1 Period register
PWM8_3_COMPARE_REG:                    equ 0x2a   ; DR2 Compare register
PWM8_3_CONTROL_REG:                    equ 0x2b   ; Control register
PWM8_3_FUNC_REG:                       equ 0x28   ; Function register
PWM8_3_INPUT_REG:                      equ 0x29   ; Input register
PWM8_3_OUTPUT_REG:                     equ 0x2a   ; Output register


;--------------------------------------------------
; PWM8_3 Macro 'Functions'
;--------------------------------------------------

   macro PWM8_3_Start_M
   or    reg[PWM8_3_CONTROL_REG],  PWM8_3_CONTROL_REG_START_BIT
   endm

   macro PWM8_3_Stop_M
   and   reg[PWM8_3_CONTROL_REG], ~PWM8_3_CONTROL_REG_START_BIT
   endm

   macro PWM8_3_EnableInt_M
   M8C_EnableIntMask PWM8_3_INT_REG, PWM8_3_INT_MASK
   endm

   macro PWM8_3_DisableInt_M
   M8C_DisableIntMask PWM8_3_INT_REG, PWM8_3_INT_MASK
   endm


; end of file PWM8_3.inc
