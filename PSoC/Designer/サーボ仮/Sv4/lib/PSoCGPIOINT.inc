;  Generated by PSoC Designer 5.4.2946
;
; sv1 address and mask equates
sv1_Data_ADDR:	equ	0h
sv1_DriveMode_0_ADDR:	equ	100h
sv1_DriveMode_1_ADDR:	equ	101h
sv1_DriveMode_2_ADDR:	equ	3h
sv1_GlobalSelect_ADDR:	equ	2h
sv1_IntCtrl_0_ADDR:	equ	102h
sv1_IntCtrl_1_ADDR:	equ	103h
sv1_IntEn_ADDR:	equ	1h
sv1_MASK:	equ	1h
; sv2 address and mask equates
sv2_Data_ADDR:	equ	0h
sv2_DriveMode_0_ADDR:	equ	100h
sv2_DriveMode_1_ADDR:	equ	101h
sv2_DriveMode_2_ADDR:	equ	3h
sv2_GlobalSelect_ADDR:	equ	2h
sv2_IntCtrl_0_ADDR:	equ	102h
sv2_IntCtrl_1_ADDR:	equ	103h
sv2_IntEn_ADDR:	equ	1h
sv2_MASK:	equ	2h
; mmdownPWM address and mask equates
mmdownPWM_Data_ADDR:	equ	0h
mmdownPWM_DriveMode_0_ADDR:	equ	100h
mmdownPWM_DriveMode_1_ADDR:	equ	101h
mmdownPWM_DriveMode_2_ADDR:	equ	3h
mmdownPWM_GlobalSelect_ADDR:	equ	2h
mmdownPWM_IntCtrl_0_ADDR:	equ	102h
mmdownPWM_IntCtrl_1_ADDR:	equ	103h
mmdownPWM_IntEn_ADDR:	equ	1h
mmdownPWM_MASK:	equ	4h
; mmupPWM address and mask equates
mmupPWM_Data_ADDR:	equ	0h
mmupPWM_DriveMode_0_ADDR:	equ	100h
mmupPWM_DriveMode_1_ADDR:	equ	101h
mmupPWM_DriveMode_2_ADDR:	equ	3h
mmupPWM_GlobalSelect_ADDR:	equ	2h
mmupPWM_IntCtrl_0_ADDR:	equ	102h
mmupPWM_IntCtrl_1_ADDR:	equ	103h
mmupPWM_IntEn_ADDR:	equ	1h
mmupPWM_MASK:	equ	8h
; Port04 address and mask equates
Port04_Data_ADDR:	equ	0h
Port04_DriveMode_0_ADDR:	equ	100h
Port04_DriveMode_1_ADDR:	equ	101h
Port04_DriveMode_2_ADDR:	equ	3h
Port04_GlobalSelect_ADDR:	equ	2h
Port04_IntCtrl_0_ADDR:	equ	102h
Port04_IntCtrl_1_ADDR:	equ	103h
Port04_IntEn_ADDR:	equ	1h
Port04_MASK:	equ	10h
; Port05 address and mask equates
Port05_Data_ADDR:	equ	0h
Port05_DriveMode_0_ADDR:	equ	100h
Port05_DriveMode_1_ADDR:	equ	101h
Port05_DriveMode_2_ADDR:	equ	3h
Port05_GlobalSelect_ADDR:	equ	2h
Port05_IntCtrl_0_ADDR:	equ	102h
Port05_IntCtrl_1_ADDR:	equ	103h
Port05_IntEn_ADDR:	equ	1h
Port05_MASK:	equ	20h
; mzdownV address and mask equates
mzdownV_Data_ADDR:	equ	4h
mzdownV_DriveMode_0_ADDR:	equ	104h
mzdownV_DriveMode_1_ADDR:	equ	105h
mzdownV_DriveMode_2_ADDR:	equ	7h
mzdownV_GlobalSelect_ADDR:	equ	6h
mzdownV_IntCtrl_0_ADDR:	equ	106h
mzdownV_IntCtrl_1_ADDR:	equ	107h
mzdownV_IntEn_ADDR:	equ	5h
mzdownV_MASK:	equ	1h
; mzupV address and mask equates
mzupV_Data_ADDR:	equ	4h
mzupV_DriveMode_0_ADDR:	equ	104h
mzupV_DriveMode_1_ADDR:	equ	105h
mzupV_DriveMode_2_ADDR:	equ	7h
mzupV_GlobalSelect_ADDR:	equ	6h
mzupV_IntCtrl_0_ADDR:	equ	106h
mzupV_IntCtrl_1_ADDR:	equ	107h
mzupV_IntEn_ADDR:	equ	5h
mzupV_MASK:	equ	4h
; Port14 address and mask equates
Port14_Data_ADDR:	equ	4h
Port14_DriveMode_0_ADDR:	equ	104h
Port14_DriveMode_1_ADDR:	equ	105h
Port14_DriveMode_2_ADDR:	equ	7h
Port14_GlobalSelect_ADDR:	equ	6h
Port14_IntCtrl_0_ADDR:	equ	106h
Port14_IntCtrl_1_ADDR:	equ	107h
Port14_IntEn_ADDR:	equ	5h
Port14_MASK:	equ	10h
; EzI2Cs_1SDA address and mask equates
EzI2Cs_1SDA_Data_ADDR:	equ	4h
EzI2Cs_1SDA_DriveMode_0_ADDR:	equ	104h
EzI2Cs_1SDA_DriveMode_1_ADDR:	equ	105h
EzI2Cs_1SDA_DriveMode_2_ADDR:	equ	7h
EzI2Cs_1SDA_GlobalSelect_ADDR:	equ	6h
EzI2Cs_1SDA_IntCtrl_0_ADDR:	equ	106h
EzI2Cs_1SDA_IntCtrl_1_ADDR:	equ	107h
EzI2Cs_1SDA_IntEn_ADDR:	equ	5h
EzI2Cs_1SDA_MASK:	equ	20h
; Port16 address and mask equates
Port16_Data_ADDR:	equ	4h
Port16_DriveMode_0_ADDR:	equ	104h
Port16_DriveMode_1_ADDR:	equ	105h
Port16_DriveMode_2_ADDR:	equ	7h
Port16_GlobalSelect_ADDR:	equ	6h
Port16_IntCtrl_0_ADDR:	equ	106h
Port16_IntCtrl_1_ADDR:	equ	107h
Port16_IntEn_ADDR:	equ	5h
Port16_MASK:	equ	40h
; EzI2Cs_1SCL address and mask equates
EzI2Cs_1SCL_Data_ADDR:	equ	4h
EzI2Cs_1SCL_DriveMode_0_ADDR:	equ	104h
EzI2Cs_1SCL_DriveMode_1_ADDR:	equ	105h
EzI2Cs_1SCL_DriveMode_2_ADDR:	equ	7h
EzI2Cs_1SCL_GlobalSelect_ADDR:	equ	6h
EzI2Cs_1SCL_IntCtrl_0_ADDR:	equ	106h
EzI2Cs_1SCL_IntCtrl_1_ADDR:	equ	107h
EzI2Cs_1SCL_IntEn_ADDR:	equ	5h
EzI2Cs_1SCL_MASK:	equ	80h
; mmdownV address and mask equates
mmdownV_Data_ADDR:	equ	8h
mmdownV_DriveMode_0_ADDR:	equ	108h
mmdownV_DriveMode_1_ADDR:	equ	109h
mmdownV_DriveMode_2_ADDR:	equ	bh
mmdownV_GlobalSelect_ADDR:	equ	ah
mmdownV_IntCtrl_0_ADDR:	equ	10ah
mmdownV_IntCtrl_1_ADDR:	equ	10bh
mmdownV_IntEn_ADDR:	equ	9h
mmdownV_MASK:	equ	1h
; mmupV address and mask equates
mmupV_Data_ADDR:	equ	8h
mmupV_DriveMode_0_ADDR:	equ	108h
mmupV_DriveMode_1_ADDR:	equ	109h
mmupV_DriveMode_2_ADDR:	equ	bh
mmupV_GlobalSelect_ADDR:	equ	ah
mmupV_IntCtrl_0_ADDR:	equ	10ah
mmupV_IntCtrl_1_ADDR:	equ	10bh
mmupV_IntEn_ADDR:	equ	9h
mmupV_MASK:	equ	4h
; Port23 address and mask equates
Port23_Data_ADDR:	equ	8h
Port23_DriveMode_0_ADDR:	equ	108h
Port23_DriveMode_1_ADDR:	equ	109h
Port23_DriveMode_2_ADDR:	equ	bh
Port23_GlobalSelect_ADDR:	equ	ah
Port23_IntCtrl_0_ADDR:	equ	10ah
Port23_IntCtrl_1_ADDR:	equ	10bh
Port23_IntEn_ADDR:	equ	9h
Port23_MASK:	equ	8h
; mzdownPWM address and mask equates
mzdownPWM_Data_ADDR:	equ	8h
mzdownPWM_DriveMode_0_ADDR:	equ	108h
mzdownPWM_DriveMode_1_ADDR:	equ	109h
mzdownPWM_DriveMode_2_ADDR:	equ	bh
mzdownPWM_GlobalSelect_ADDR:	equ	ah
mzdownPWM_IntCtrl_0_ADDR:	equ	10ah
mzdownPWM_IntCtrl_1_ADDR:	equ	10bh
mzdownPWM_IntEn_ADDR:	equ	9h
mzdownPWM_MASK:	equ	10h
; mzupPWM address and mask equates
mzupPWM_Data_ADDR:	equ	8h
mzupPWM_DriveMode_0_ADDR:	equ	108h
mzupPWM_DriveMode_1_ADDR:	equ	109h
mzupPWM_DriveMode_2_ADDR:	equ	bh
mzupPWM_GlobalSelect_ADDR:	equ	ah
mzupPWM_IntCtrl_0_ADDR:	equ	10ah
mzupPWM_IntCtrl_1_ADDR:	equ	10bh
mzupPWM_IntEn_ADDR:	equ	9h
mzupPWM_MASK:	equ	20h
